## CMakeLists.txt
```
# SPDX-License-Identifier: Apache-2.0

cmake_minimum_required(VERSION 3.20.0)
find_package(Zephyr REQUIRED HINTS $ENV{ZEPHYR_BASE})
project(mpipe_ipc_protocol_test)

file(GLOB app_sources src/*.c)
target_sources(app PRIVATE ${app_sources})
```

## prj.conf
```kconfig
CONFIG_ZTEST=y
CONFIG_MPIPE=y
CONFIG_MPIPE_IPC=y
```

## src/main.c
```c
/*
 * Copyright 2026 NXP
 *
 * SPDX-License-Identifier: Apache-2.0
 */

#include <zephyr/ztest.h>
#include <string.h>

#include <zephyr/mpipe/ipc/mpipe_ipc_protocol.h>
#include <zephyr/mpipe/ipc/mpipe_ipc_session.h>

ZTEST_SUITE(mpipe_ipc, NULL, NULL, NULL, NULL, NULL);

static uint8_t scratch[MPIPE_IPC_MAX_MESSAGE];

/* ------------------------------------------------------------------ */
/* Control header                                                      */
/* ------------------------------------------------------------------ */

/*
 * Four bytes on purpose. ipc_service's receive callback supplies the length
 * and its endpoints are named, so neither a size nor a stream id earns a
 * place; peer identity lives in the session word, not on each message.
 */
ZTEST(mpipe_ipc, test_header_is_four_bytes)
{
	zassert_equal(MPIPE_IPC_HEADER_LENGTH, 4U);
	zassert_equal(MPIPE_IPC_OFF_CMD, 0U);
}

ZTEST(mpipe_ipc, test_cmd_packs_type_and_transaction_id)
{
	uint32_t cmd = MPIPE_IPC_CMD(MPIPE_IPC_TYPE_CONFIG, 0xbeef);

	zassert_equal(MPIPE_IPC_CMD_TYPE(cmd), MPIPE_IPC_TYPE_CONFIG);
	zassert_equal(MPIPE_IPC_CMD_ID(cmd), 0xbeef);
}

ZTEST(mpipe_ipc, test_encode_is_little_endian_and_round_trips)
{
	struct mpipe_ipc_message in = {
		.header = { .cmd = MPIPE_IPC_CMD(MPIPE_IPC_TYPE_HELLO, 0x1234) },
		.payload = (const uint8_t *)"abcd",
		.payload_length = 4U,
	};
	struct mpipe_ipc_message out;
	size_t written = 0;

	zassert_ok(mpipe_ipc_encode(scratch, sizeof(scratch), &in, &written));
	zassert_equal(written, MPIPE_IPC_HEADER_LENGTH + 4U);
	zassert_equal(sys_get_le32(&scratch[MPIPE_IPC_OFF_CMD]), in.header.cmd);
	zassert_equal(scratch[0], 0x34, "transaction id is little-endian");

	zassert_ok(mpipe_ipc_decode(&out, scratch, written));
	zassert_equal(out.header.cmd, in.header.cmd);
	zassert_equal(out.payload_length, 4U);
	zassert_mem_equal(out.payload, "abcd", 4);
}

ZTEST(mpipe_ipc, test_header_only_message_is_legal)
{
	struct mpipe_ipc_message in = {
		.header = { .cmd = MPIPE_IPC_CMD(MPIPE_IPC_TYPE_HEARTBEAT, 1) },
	};
	struct mpipe_ipc_message out;
	size_t written = 0;

	zassert_ok(mpipe_ipc_encode(scratch, sizeof(scratch), &in, &written));
	zassert_equal(written, MPIPE_IPC_HEADER_LENGTH);
	zassert_ok(mpipe_ipc_decode(&out, scratch, written));
	zassert_equal(out.payload_length, 0U);
	zassert_is_null(out.payload, "no payload means no pointer");
}

/* The format must not depend on receive-buffer alignment. */
ZTEST(mpipe_ipc, test_decode_accepts_an_unaligned_buffer)
{
	static uint8_t staging[MPIPE_IPC_MAX_MESSAGE + 3];
	struct mpipe_ipc_message in = {
		.header = { .cmd = MPIPE_IPC_CMD(MPIPE_IPC_TYPE_STATUS, 7) },
		.payload = (const uint8_t *)"xy",
		.payload_length = 2U,
	};
	struct mpipe_ipc_message out;
	size_t written = 0;

	zassert_ok(mpipe_ipc_encode(scratch, sizeof(scratch), &in, &written));
	memcpy(&staging[1], scratch, written);

	zassert_ok(mpipe_ipc_decode(&out, &staging[1], written));
	zassert_equal(out.header.cmd, in.header.cmd);
}

ZTEST(mpipe_ipc, test_malformed_messages_are_rejected)
{
	struct mpipe_ipc_message out;

	zassert_equal(mpipe_ipc_decode(NULL, scratch, 8U), -EINVAL);
	zassert_equal(mpipe_ipc_decode(&out, NULL, 8U), -EINVAL);

	/* Shorter than a header. */
	zassert_equal(mpipe_ipc_decode(&out, scratch, MPIPE_IPC_HEADER_LENGTH - 1U),
		      -EMSGSIZE);

	/* Unknown type. */
	sys_put_le32(MPIPE_IPC_CMD(0x7f, 1), &scratch[MPIPE_IPC_OFF_CMD]);
	zassert_equal(mpipe_ipc_decode(&out, scratch, MPIPE_IPC_HEADER_LENGTH),
		      -ENOTSUP);

	/* Longer than the control ceiling. */
	sys_put_le32(MPIPE_IPC_CMD(MPIPE_IPC_TYPE_STATUS, 1), &scratch[MPIPE_IPC_OFF_CMD]);
	zassert_equal(mpipe_ipc_decode(&out, scratch, MPIPE_IPC_MAX_MESSAGE + 1U),
		      -EMSGSIZE);
}

ZTEST(mpipe_ipc, test_rejected_message_leaves_no_payload_pointer)
{
	struct mpipe_ipc_message out;

	sys_put_le32(MPIPE_IPC_CMD(0x7f, 1), &scratch[MPIPE_IPC_OFF_CMD]);
	out.payload = (const uint8_t *)0x1;
	out.payload_length = 12345U;

	zassert_equal(mpipe_ipc_decode(&out, scratch, MPIPE_IPC_HEADER_LENGTH), -ENOTSUP);
	zassert_is_null(out.payload);
	zassert_equal(out.payload_length, 0U);
}

ZTEST(mpipe_ipc, test_encode_argument_and_capacity_rules)
{
	struct mpipe_ipc_message in = {
		.header = { .cmd = MPIPE_IPC_CMD(MPIPE_IPC_TYPE_HEARTBEAT, 1) },
	};
	size_t written = 0;

	zassert_equal(mpipe_ipc_encode(NULL, sizeof(scratch), &in, &written), -EINVAL);
	zassert_equal(mpipe_ipc_encode(scratch, sizeof(scratch), NULL, &written), -EINVAL);
	zassert_equal(mpipe_ipc_encode(scratch, sizeof(scratch), &in, NULL), -EINVAL);
	zassert_equal(mpipe_ipc_encode(scratch, 1U, &in, &written), -ENOSPC);

	in.payload = scratch;
	in.payload_length = MPIPE_IPC_MAX_PAYLOAD + 1U;
	zassert_equal(mpipe_ipc_encode(scratch, sizeof(scratch), &in, &written), -EMSGSIZE);
}

/* ------------------------------------------------------------------ */
/* Audio format negotiation                                            */
/* ------------------------------------------------------------------ */

ZTEST(mpipe_ipc, test_audio_format_round_trips_through_config)
{
	const struct mpipe_ipc_audio_format in = MPIPE_IPC_V1_AUDIO_FORMAT;
	struct mpipe_ipc_message message;
	uint8_t buf[MPIPE_IPC_AUDIO_FORMAT_LENGTH];

	zassert_equal(mpipe_ipc_audio_format_encode(buf, sizeof(buf), &in),
		      MPIPE_IPC_AUDIO_FORMAT_LENGTH);

	message.header.cmd = MPIPE_IPC_CMD(MPIPE_IPC_TYPE_CONFIG, 1);
	message.payload = buf;
	message.payload_length = sizeof(buf);

	zassert_ok(mpipe_ipc_validate_audio(&message, &in));
}

/* The slow-consumer policy is negotiated, not a credit window. */
ZTEST(mpipe_ipc, test_xrun_policy_is_part_of_the_negotiated_format)
{
	struct mpipe_ipc_audio_format in = MPIPE_IPC_V1_AUDIO_FORMAT;
	const struct mpipe_ipc_audio_format expected = MPIPE_IPC_V1_AUDIO_FORMAT;
	struct mpipe_ipc_message message;
	uint8_t buf[MPIPE_IPC_AUDIO_FORMAT_LENGTH];

	zassert_true(expected.overrun_permitted, "v1 permits overrun");
	zassert_false(expected.underrun_permitted);

	in.overrun_permitted = false;
	zassert_equal(mpipe_ipc_audio_format_encode(buf, sizeof(buf), &in),
		      MPIPE_IPC_AUDIO_FORMAT_LENGTH);

	message.header.cmd = MPIPE_IPC_CMD(MPIPE_IPC_TYPE_CONFIG, 1);
	message.payload = buf;
	message.payload_length = sizeof(buf);

	zassert_equal(mpipe_ipc_validate_audio(&message, &expected), -EPROTO);
}

ZTEST(mpipe_ipc, test_audio_validation_rejects_a_non_config_message)
{
	const struct mpipe_ipc_audio_format expected = MPIPE_IPC_V1_AUDIO_FORMAT;
	struct mpipe_ipc_message message = {
		.header = { .cmd = MPIPE_IPC_CMD(MPIPE_IPC_TYPE_HEARTBEAT, 1) },
	};

	zassert_equal(mpipe_ipc_validate_audio(&message, &expected), -ENOTSUP);
}

/* ------------------------------------------------------------------ */
/* Session handshake                                                   */
/* ------------------------------------------------------------------ */

ZTEST(mpipe_ipc, test_handshake_word_packs_request_and_ack)
{
	uint32_t word = MPIPE_IPC_HANDSHAKE(0x1234, 0xabcd);

	zassert_equal(MPIPE_IPC_HANDSHAKE_REQ(word), 0x1234);
	zassert_equal(MPIPE_IPC_HANDSHAKE_ACK(word), 0xabcd);
}

/*
 * The new session is derived from the value read back out of shared memory.
 * A core that started from local state would pick the same number every boot
 * and be indistinguishable from a core that never restarted.
 */
ZTEST(mpipe_ipc, test_next_session_increments_from_the_retained_value)
{
	zassert_equal(mpipe_ipc_session_next(5U, 99U), 6U);
	zassert_equal(mpipe_ipc_session_next(41U, 99U), 42U);
}

ZTEST(mpipe_ipc, test_next_session_skips_zero_on_wrap)
{
	zassert_equal(mpipe_ipc_session_next(0xffffU, 99U), 1U,
		      "zero is reserved for no session");
}

ZTEST(mpipe_ipc, test_next_session_skips_the_value_the_peer_acknowledged)
{
	zassert_equal(mpipe_ipc_session_next(7U, 8U), 9U,
		      "a fresh session must not collide with the acknowledged one");
}

ZTEST(mpipe_ipc, test_open_latch_and_steady_state)
{
	struct mpipe_ipc_session s;
	uint32_t peer;

	zassert_ok(mpipe_ipc_session_open(&s, MPIPE_IPC_HANDSHAKE(4U, 0U), 0U));
	zassert_equal(s.local_sid, 5U);
	zassert_false(s.connected);

	/* Nothing may be checked before a peer session is latched. */
	zassert_equal(mpipe_ipc_session_check(&s, MPIPE_IPC_HANDSHAKE(77U, 0U)),
		      -ENOTCONN);

	peer = MPIPE_IPC_HANDSHAKE(77U, 5U);
	zassert_ok(mpipe_ipc_session_latch(&s, peer));
	zassert_true(s.connected);
	zassert_equal(s.remote_sid, 77U);
	zassert_true(mpipe_ipc_session_acknowledged(&s, peer),
		     "the peer echoed our session, so the handshake is complete");

	zassert_ok(mpipe_ipc_session_check(&s, peer));
	zassert_equal(MPIPE_IPC_HANDSHAKE_REQ(mpipe_ipc_session_word(&s)), 5U);
	zassert_equal(MPIPE_IPC_HANDSHAKE_ACK(mpipe_ipc_session_word(&s)), 77U);
}

ZTEST(mpipe_ipc, test_latch_waits_for_a_published_peer_session)
{
	struct mpipe_ipc_session s;

	zassert_ok(mpipe_ipc_session_open(&s, 0U, 0U));
	zassert_equal(mpipe_ipc_session_latch(&s, MPIPE_IPC_HANDSHAKE(0U, 0U)), -EAGAIN);
	zassert_false(s.connected);
}

/* The case the whole mechanism exists for. */
ZTEST(mpipe_ipc, test_restarted_peer_is_detected_and_disconnects)
{
	struct mpipe_ipc_session s;

	zassert_ok(mpipe_ipc_session_open(&s, 0U, 0U));
	zassert_ok(mpipe_ipc_session_latch(&s, MPIPE_IPC_HANDSHAKE(77U, 1U)));
	zassert_ok(mpipe_ipc_session_check(&s, MPIPE_IPC_HANDSHAKE(77U, 1U)));

	/* The peer reboots and publishes a new session. */
	zassert_equal(mpipe_ipc_session_check(&s, MPIPE_IPC_HANDSHAKE(78U, 0U)),
		      -ECONNRESET);
	zassert_false(s.connected, "a restarted peer drops the session");
	zassert_equal(s.remote_sid, MPIPE_IPC_SID_NONE);

	/* And stays dropped until deliberately re-latched. */
	zassert_equal(mpipe_ipc_session_check(&s, MPIPE_IPC_HANDSHAKE(78U, 0U)),
		      -ENOTCONN);
}

ZTEST(mpipe_ipc, test_acknowledgement_is_one_way_until_the_peer_echoes)
{
	struct mpipe_ipc_session s;

	zassert_ok(mpipe_ipc_session_open(&s, 0U, 0U));
	zassert_ok(mpipe_ipc_session_latch(&s, MPIPE_IPC_HANDSHAKE(77U, 0U)));

	zassert_false(mpipe_ipc_session_acknowledged(&s, MPIPE_IPC_HANDSHAKE(77U, 0U)),
		      "peer has not echoed our session yet");
	zassert_true(mpipe_ipc_session_acknowledged(&s,
						    MPIPE_IPC_HANDSHAKE(77U, s.local_sid)));
}

ZTEST(mpipe_ipc, test_session_argument_rules)
{
	zassert_equal(mpipe_ipc_session_open(NULL, 0U, 0U), -EINVAL);
	zassert_equal(mpipe_ipc_session_latch(NULL, 0U), -EINVAL);
	zassert_equal(mpipe_ipc_session_check(NULL, 0U), -EINVAL);
	zassert_false(mpipe_ipc_session_acknowledged(NULL, 0U));
}

/* ------------------------------------------------------------------ */
/* Rendezvous barrier                                                  */
/* ------------------------------------------------------------------ */

#define HOST   true
#define REMOTE false
#define EXPECTED_FAULT_STATE 3U

/*
 * A published state word carries the session that published it, so a test that
 * acts as one incarnation stamps the state it publishes with that incarnation's
 * own session -- which is what a real peer's publish() writes. The cases that
 * deliberately mismatch the two stamp the word themselves.
 */
static uint32_t published(uint32_t peer_session_word, uint32_t state)
{
	return MPIPE_IPC_STATE_WORD(MPIPE_IPC_HANDSHAKE_REQ(peer_session_word), state);
}

#define STEP(session, is_host, require_peer, word, state)                                          \
	mpipe_ipc_bringup_step((session), (is_host), (require_peer), (word),                       \
			       published((word), (state)))

/* Cold boot: host may proceed with no peer at all; the remote may not. */
ZTEST(mpipe_ipc, test_cold_boot_host_opens_alone_remote_waits)
{
	struct mpipe_ipc_session h, r;

	zassert_ok(mpipe_ipc_session_open(&h, 0U, 0U));
	zassert_ok(mpipe_ipc_session_open(&r, 0U, 0U));

	zassert_equal(STEP(&h, HOST, false, 0U, MPIPE_IPC_BRINGUP_DOWN),
		      MPIPE_IPC_ACTION_OPEN, "host owns the rings");
	zassert_equal(STEP(&r, REMOTE, false, 0U, MPIPE_IPC_BRINGUP_DOWN),
		      MPIPE_IPC_ACTION_WAIT, "remote must never build rings");
}

/* The remote attaches only once the host has finished initialising. */
ZTEST(mpipe_ipc, test_remote_waits_for_host_ready)
{
	struct mpipe_ipc_session r;
	uint32_t host_word;

	zassert_ok(mpipe_ipc_session_open(&r, 0U, 0U));

	/* A host that has not acknowledged this remote may be long gone. */
	zassert_equal(STEP(&r, REMOTE, false, MPIPE_IPC_HANDSHAKE(11U, 0U), MPIPE_IPC_BRINGUP_READY),
		      MPIPE_IPC_ACTION_WAIT, "an unacknowledged READY may be residue");
	zassert_false(r.connected);

	host_word = MPIPE_IPC_HANDSHAKE(11U, r.local_sid);

	zassert_equal(STEP(&r, REMOTE, false, host_word, MPIPE_IPC_BRINGUP_CLAIMED),
		      MPIPE_IPC_ACTION_WAIT, "host has not built the rings yet");
	zassert_true(r.connected, "but the peer session is latched while waiting");

	zassert_equal(STEP(&r, REMOTE, false, host_word, MPIPE_IPC_BRINGUP_READY),
		      MPIPE_IPC_ACTION_OPEN);
}

/*
 * The case that makes the barrier necessary: a restarted host must not call
 * open() while the remote is live, because open() zeroes both vrings.
 */
ZTEST(mpipe_ipc, test_restarted_host_must_not_wipe_a_live_remote)
{
	struct mpipe_ipc_session h;
	uint32_t remote_word = MPIPE_IPC_HANDSHAKE(77U, 0U);

	zassert_ok(mpipe_ipc_session_open(&h, 0U, 0U));

	zassert_equal(STEP(&h, HOST, false, remote_word, MPIPE_IPC_BRINGUP_READY),
		      MPIPE_IPC_ACTION_WAIT,
		      "host must stand off while the remote is using the rings");

	/* The remote notices the new host session, tears down, and stands by. */
	zassert_equal(STEP(&h, HOST, false, remote_word, MPIPE_IPC_BRINGUP_CLAIMED),
		      MPIPE_IPC_ACTION_OPEN);
}

/* The mirror direction must also converge rather than deadlock. */
ZTEST(mpipe_ipc, test_restarted_remote_converges)
{
	struct mpipe_ipc_session h, r;
	uint32_t remote_v1, remote_v2;
	uint32_t host_word;

	/* Steady state: both up, with the remote acknowledging this host boot. */
	zassert_ok(mpipe_ipc_session_open(&h, 0U, 0U));
	remote_v1 = MPIPE_IPC_HANDSHAKE(77U, h.local_sid);
	remote_v2 = MPIPE_IPC_HANDSHAKE(78U, h.local_sid);

	zassert_equal(STEP(&h, HOST, false, remote_v1, MPIPE_IPC_BRINGUP_CLAIMED),
		      MPIPE_IPC_ACTION_OPEN);
	zassert_true(h.connected);
	host_word = mpipe_ipc_session_word(&h);

	/* The remote reboots and publishes a new session. */
	zassert_equal(STEP(&h, HOST, false, remote_v2, MPIPE_IPC_BRINGUP_CLAIMED),
		      MPIPE_IPC_ACTION_FAULT, "host sees a different incarnation");
	zassert_false(h.connected);

	/* Host tears down, re-opens a session, and both converge. */
	zassert_ok(mpipe_ipc_session_open(&h, host_word, 0U));
	zassert_equal(STEP(&h, HOST, false, remote_v2, MPIPE_IPC_BRINGUP_CLAIMED),
		      MPIPE_IPC_ACTION_OPEN);

	/*
	 * The remote's own session is 78 here, so the host's published
	 * acknowledgement of 78 is what lets the remote accept it.
	 */
	zassert_ok(mpipe_ipc_session_open(&r, MPIPE_IPC_HANDSHAKE(77U, 0U), 0U));
	zassert_equal(r.local_sid, 78U);
	zassert_equal(STEP(&r, REMOTE, false, mpipe_ipc_session_word(&h), MPIPE_IPC_BRINGUP_READY),
		      MPIPE_IPC_ACTION_OPEN, "remote attaches to the rebuilt rings");
}

/* A peer that claims READY without a session is impossible and is distrusted. */
ZTEST(mpipe_ipc, test_ready_without_a_session_is_rejected)
{
	struct mpipe_ipc_session s;

	zassert_ok(mpipe_ipc_session_open(&s, 0U, 0U));
	zassert_equal(STEP(&s, REMOTE, false, 0U, MPIPE_IPC_BRINGUP_READY),
		      MPIPE_IPC_ACTION_FAULT);
	zassert_equal(STEP(&s, HOST, false, 0U, MPIPE_IPC_BRINGUP_READY),
		      MPIPE_IPC_ACTION_FAULT);
}

/* A faulted peer may still own the rings, so neither role may open against it. */
ZTEST(mpipe_ipc, test_fault_and_unknown_peer_states_never_authorize_open)
{
	struct mpipe_ipc_session h;
	uint32_t peer_word;

	zassert_ok(mpipe_ipc_session_open(&h, 0U, 0U));
	peer_word = MPIPE_IPC_HANDSHAKE(9U, h.local_sid);

	zassert_equal(STEP(&h, HOST, false, peer_word, EXPECTED_FAULT_STATE),
		      MPIPE_IPC_ACTION_FAULT);
	zassert_false(h.connected, "a faulted peer must not be latched");
	zassert_equal(STEP(&h, REMOTE, false, peer_word, EXPECTED_FAULT_STATE),
		      MPIPE_IPC_ACTION_FAULT);
	zassert_equal(STEP(&h, HOST, false, peer_word, UINT32_MAX),
		      MPIPE_IPC_ACTION_FAULT);
}

/* A peer that disappears after being latched is a fault, not a cold start. */
ZTEST(mpipe_ipc, test_peer_vanishing_after_latch_faults)
{
	struct mpipe_ipc_session s;

	zassert_ok(mpipe_ipc_session_open(&s, 0U, 0U));
	zassert_equal(STEP(&s, HOST, false, MPIPE_IPC_HANDSHAKE(9U, s.local_sid),
			   MPIPE_IPC_BRINGUP_CLAIMED),
		      MPIPE_IPC_ACTION_OPEN);
	zassert_true(s.connected);

	zassert_equal(STEP(&s, HOST, false, 0U, MPIPE_IPC_BRINGUP_DOWN),
		      MPIPE_IPC_ACTION_FAULT);
	zassert_false(s.connected);
}

ZTEST(mpipe_ipc, test_bringup_rejects_null)
{
	zassert_equal(STEP(NULL, HOST, false, 0U, 0U),
		      MPIPE_IPC_ACTION_FAULT);
}

/*
 * The acknowledgement half is what separates a live peer from the word a dead
 * one left behind, so a session that a peer could already have acknowledged
 * must never be reissued.
 */
ZTEST(mpipe_ipc, test_an_unacknowledged_session_is_not_accepted)
{
	struct mpipe_ipc_session h;

	zassert_ok(mpipe_ipc_session_open(&h, 0U, 0U));

	zassert_equal(STEP(&h, HOST, false, MPIPE_IPC_HANDSHAKE(3U, 0U), MPIPE_IPC_BRINGUP_CLAIMED),
		      MPIPE_IPC_ACTION_OPEN, "residue must not block the host");
	zassert_false(h.connected, "and must not be mistaken for a peer");

	/* But it is still echoed, which is how a real peer learns we are here. */
	zassert_equal(MPIPE_IPC_HANDSHAKE_ACK(mpipe_ipc_session_word(&h)), 3U);
}

/*
 * Where the mailbox belongs to the peer's power domain, a host that opens
 * before the peer exists configures hardware that is not clocked. The writes
 * are discarded silently, so bring-up appears to succeed and the link then runs
 * one way forever. On the i.MX8MP that cost every doorbell into the host.
 */
ZTEST(mpipe_ipc, test_a_host_that_needs_its_peer_waits_for_it)
{
	struct mpipe_ipc_session h;
	uint32_t unacknowledged = MPIPE_IPC_HANDSHAKE(7U, 0U);
	uint32_t acknowledged;

	zassert_ok(mpipe_ipc_session_open(&h, 0U, 0U));
	acknowledged = MPIPE_IPC_HANDSHAKE(7U, h.local_sid);

	/* Without the peer's acknowledgement there is no proof it is powered. */
	zassert_equal(STEP(&h, HOST, true, 0U, MPIPE_IPC_BRINGUP_DOWN),
		      MPIPE_IPC_ACTION_WAIT, "no peer at all");
	zassert_equal(STEP(&h, HOST, true, unacknowledged, MPIPE_IPC_BRINGUP_CLAIMED),
		      MPIPE_IPC_ACTION_WAIT, "a word, but nobody behind it");

	/* The same peer word, now acknowledging this boot, is proof enough. */
	zassert_equal(STEP(&h, HOST, true, acknowledged, MPIPE_IPC_BRINGUP_CLAIMED),
		      MPIPE_IPC_ACTION_OPEN);

	/* And the default is unchanged: a host may still come up alone. */
	zassert_ok(mpipe_ipc_session_open(&h, 0U, 0U));
	zassert_equal(STEP(&h, HOST, false, 0U, MPIPE_IPC_BRINGUP_DOWN),
		      MPIPE_IPC_ACTION_OPEN);
}

/*
 * The mixed sample the stamp exists for. A host that restarts publishes its new
 * session word before it publishes a state to go with it, so for a moment its
 * block holds a new session next to the READY its previous life left behind.
 * Read as a pair, those two words invite the remote into rings the new host has
 * not built.
 */
ZTEST(mpipe_ipc, test_a_ready_from_the_peers_previous_life_is_not_an_invitation)
{
	struct mpipe_ipc_session r;
	uint32_t restarted_host;

	zassert_ok(mpipe_ipc_session_open(&r, 0U, 0U));
	restarted_host = MPIPE_IPC_HANDSHAKE(9U, r.local_sid);

	zassert_equal(mpipe_ipc_bringup_step(&r, REMOTE, false, restarted_host,
					     MPIPE_IPC_STATE_WORD(5U,
								  MPIPE_IPC_BRINGUP_READY)),
		      MPIPE_IPC_ACTION_WAIT,
		      "a READY stamped with the host's previous session is not this one's");

	/* One poll later the host has stamped the state to match, and it is. */
	zassert_equal(STEP(&r, REMOTE, false, restarted_host, MPIPE_IPC_BRINGUP_READY),
		      MPIPE_IPC_ACTION_OPEN);
}

/*
 * The same disagreement seen from the host, where the conservative reading is
 * the opposite one: a state that is not this session's must not be dismissed as
 * "not READY" either, because the live half of the pair may be the state and the
 * torn half the session word -- and opening on that wipes rings a remote holds.
 */
ZTEST(mpipe_ipc, test_a_host_does_not_read_a_disagreeing_pair_as_an_idle_peer)
{
	struct mpipe_ipc_session h;

	zassert_ok(mpipe_ipc_session_open(&h, 0U, 0U));

	zassert_equal(mpipe_ipc_bringup_step(&h, HOST, false, MPIPE_IPC_HANDSHAKE(3U, 0U),
					     MPIPE_IPC_STATE_WORD(2U,
								  MPIPE_IPC_BRINGUP_CLAIMED)),
		      MPIPE_IPC_ACTION_WAIT, "a CLAIMED from another session proves nothing");

	zassert_equal(STEP(&h, HOST, false, MPIPE_IPC_HANDSHAKE(3U, 0U),
			   MPIPE_IPC_BRINGUP_CLAIMED),
		      MPIPE_IPC_ACTION_OPEN, "once the pair agrees, an idle peer is idle");
}

/*
 * Waiting on a disagreeing pair must not become waiting forever: a peer that
 * died between its two stores leaves one behind permanently. The residue
 * timeout that already covers an unmoving READY has to cover this too.
 */
ZTEST(mpipe_ipc, test_a_pair_that_never_agrees_still_times_out_as_residue)
{
	struct mpipe_ipc_session h;
	uint32_t word = MPIPE_IPC_HANDSHAKE(3U, 0U);
	uint32_t orphaned = MPIPE_IPC_STATE_WORD(2U, MPIPE_IPC_BRINGUP_READY);
	unsigned int polls;

	zassert_ok(mpipe_ipc_session_open(&h, 0U, 0U));

	for (polls = 0; polls < MPIPE_IPC_RESIDUE_POLLS + 4U; polls++) {
		if (mpipe_ipc_bringup_step(&h, HOST, false, word, orphaned) ==
		    MPIPE_IPC_ACTION_OPEN) {
			break;
		}
	}

	zassert_true(polls >= MPIPE_IPC_RESIDUE_POLLS,
		     "the host must stand off before calling it residue");
	zassert_true(polls < MPIPE_IPC_RESIDUE_POLLS + 4U,
		     "a pair that never agrees must still time out");
}
```

## src/test_msg.c
```c
/*
 * Copyright 2026 NXP
 *
 * SPDX-License-Identifier: Apache-2.0
 */

/*
 * The plugin protocol's codec. These tests are what stands behind the claim
 * that a decoded message needs no further checking: everything the format can
 * state wrongly is rejected here, so the plugin only validates what depends on
 * its own state.
 */

#include <string.h>

#include <zephyr/sys/byteorder.h>
#include <zephyr/ztest.h>

#include <zephyr/mpipe/ipc/mpipe_ipc_msg.h>
#include <zephyr/mpipe/mpipe_dispatch.h>

ZTEST_SUITE(mpipe_ipc_msg, NULL, NULL, NULL, NULL, NULL);

#define DATA_LEN    20U
#define RELEASE_LEN 8U
#define EVENT_LEN   8U

/* Poison, so a byte the encoder forgets to write is visible rather than zero. */
static uint8_t frame[MPIPE_IPC_WIRE_MAX_LEN];

static size_t encode(const struct mpipe_ipc_msg *msg)
{
	size_t written;

	memset(frame, 0xaa, sizeof(frame));
	zassert_ok(mpipe_ipc_msg_encode(frame, sizeof(frame), msg, &written));

	return written;
}

/* Build the frame for a one-field audio CAPS, then let the caller corrupt it. */
static size_t encode_one_field_caps(uint8_t field_id, struct mpipe_value value)
{
	struct mpipe_ipc_msg msg = {
		.type = MPIPE_IPC_MSG_CAPS,
		.caps = {
			.media_type_id = MPIPE_MEDIA_AUDIO_PCM,
			.num_fields = 1U,
		},
	};

	msg.caps.ids[0] = field_id;
	msg.caps.values[0] = value;

	return encode(&msg);
}

ZTEST(mpipe_ipc_msg, test_data_is_twenty_little_endian_bytes)
{
	struct mpipe_ipc_msg msg = {
		.type = MPIPE_IPC_MSG_DATA_BUFFER,
		.data = {
			.offset = 0x11223344U,
			.size = 0x55667788U,
			.timestamp = 0x99aabbccU,
			.buffer_id = 0xd00dU,
			.generation = 0xbeefU,
		},
	};
	struct mpipe_ipc_msg decoded;

	zassert_equal(encode(&msg), DATA_LEN);
	zassert_equal(frame[0], MPIPE_IPC_PLUGIN_VERSION);
	zassert_equal(frame[1], MPIPE_IPC_MSG_DATA_BUFFER);
	zassert_equal(sys_get_le16(&frame[2]), 0U, "the header's padding must be zero");
	zassert_equal(sys_get_le32(&frame[4]), 0x11223344U);
	zassert_equal(sys_get_le32(&frame[8]), 0x55667788U);
	zassert_equal(sys_get_le32(&frame[12]), 0x99aabbccU);
	zassert_equal(sys_get_le16(&frame[16]), 0xd00dU);
	zassert_equal(sys_get_le16(&frame[18]), 0xbeefU);
	/* Byte order, not host order: the low byte of each field comes first. */
	zassert_equal(frame[4], 0x44U);

	zassert_ok(mpipe_ipc_msg_decode(&decoded, frame, DATA_LEN));
	zassert_equal(decoded.type, MPIPE_IPC_MSG_DATA_BUFFER);
	zassert_equal(decoded.data.offset, msg.data.offset);
	zassert_equal(decoded.data.size, msg.data.size);
	zassert_equal(decoded.data.timestamp, msg.data.timestamp);
	zassert_equal(decoded.data.buffer_id, msg.data.buffer_id);
	zassert_equal(decoded.data.generation, msg.data.generation);
}

ZTEST(mpipe_ipc_msg, test_release_and_event_round_trip)
{
	struct mpipe_ipc_msg release = {
		.type = MPIPE_IPC_MSG_DATA_RELEASE,
		.release = { .buffer_id = 63U, .generation = 0x0102U },
	};
	struct mpipe_ipc_msg event = {
		.type = MPIPE_IPC_MSG_EVENT,
		.event = { .event_type = MPIPE_DISPATCH_EOS },
	};
	struct mpipe_ipc_msg decoded;

	zassert_equal(encode(&release), RELEASE_LEN);
	zassert_ok(mpipe_ipc_msg_decode(&decoded, frame, RELEASE_LEN));
	zassert_equal(decoded.type, MPIPE_IPC_MSG_DATA_RELEASE);
	zassert_equal(decoded.release.buffer_id, 63U);
	zassert_equal(decoded.release.generation, 0x0102U);

	zassert_equal(encode(&event), EVENT_LEN);
	zassert_equal(frame[4], MPIPE_DISPATCH_EOS);
	zassert_ok(mpipe_ipc_msg_decode(&decoded, frame, EVENT_LEN));
	zassert_equal(decoded.type, MPIPE_IPC_MSG_EVENT);
	zassert_equal(decoded.event.event_type, MPIPE_DISPATCH_EOS);
}

ZTEST(mpipe_ipc_msg, test_caps_round_trip_carries_every_value_shape)
{
	struct mpipe_ipc_msg msg = {
		.type = MPIPE_IPC_MSG_CAPS,
		.caps = {
			.media_type_id = MPIPE_MEDIA_AUDIO_PCM,
			.num_fields = 3U,
		},
	};
	struct mpipe_ipc_msg decoded;
	size_t length;

	msg.caps.ids[0] = MPIPE_CAPS_SAMPLE_RATE;
	msg.caps.values[0] = (struct mpipe_value)MPIPE_VALUE_UINT_RANGE(16000, 48000, 8000);
	msg.caps.ids[1] = MPIPE_CAPS_INTERLEAVED;
	msg.caps.values[1] = (struct mpipe_value)MPIPE_VALUE_BOOLEAN(true);
	msg.caps.ids[2] = MPIPE_CAPS_BITWIDTH;
	msg.caps.values[2] = (struct mpipe_value)MPIPE_VALUE_UINT(32);

	length = encode(&msg);
	zassert_equal(length, 8U + (3U * MPIPE_IPC_WIRE_FIELD_LEN));

	zassert_ok(mpipe_ipc_msg_decode(&decoded, frame, length));
	zassert_equal(decoded.caps.media_type_id, MPIPE_MEDIA_AUDIO_PCM);
	zassert_equal(decoded.caps.num_fields, 3U);
	zassert_equal(decoded.caps.ids[0], MPIPE_CAPS_SAMPLE_RATE);
	zassert_equal(decoded.caps.values[0].type, MPIPE_TYPE_UINT_RANGE);
	zassert_equal(decoded.caps.values[0].range.min.v_uint, 16000U);
	zassert_equal(decoded.caps.values[0].range.max.v_uint, 48000U);
	zassert_equal(decoded.caps.values[0].range.step.v_uint, 8000U);
	zassert_true(decoded.caps.values[1].v_boolean);
	zassert_equal(decoded.caps.values[2].v_uint, 32U);
}

/*
 * A field means one kind of thing. A sample rate is a count of hertz, so a
 * signed value for it is not a rate with a sign -- it is a peer describing a
 * format in terms this one does not share, and there is no safe way to guess
 * which.
 */
ZTEST(mpipe_ipc_msg, test_a_field_must_carry_the_type_it_is_defined_with)
{
	struct mpipe_ipc_msg msg = {
		.type = MPIPE_IPC_MSG_CAPS,
		.caps = { .media_type_id = MPIPE_MEDIA_AUDIO_PCM, .num_fields = 1U },
	};
	size_t one_field = 8U + MPIPE_IPC_WIRE_FIELD_LEN;
	struct mpipe_ipc_msg decoded;
	size_t written;

	/* Refused on the way out, so this core never sends one. */
	msg.caps.ids[0] = MPIPE_CAPS_SAMPLE_RATE;
	msg.caps.values[0] = (struct mpipe_value)MPIPE_VALUE_INT(-5);
	zassert_equal(mpipe_ipc_msg_encode(frame, sizeof(frame), &msg, &written), -EINVAL);

	msg.caps.values[0] = (struct mpipe_value)MPIPE_VALUE_BOOLEAN(true);
	zassert_equal(mpipe_ipc_msg_encode(frame, sizeof(frame), &msg, &written), -EINVAL);

	/* And refused on the way in, which is the half that matters. */
	(void)encode_one_field_caps(MPIPE_CAPS_SAMPLE_RATE,
				    (struct mpipe_value)MPIPE_VALUE_UINT(16000));
	frame[9] = MPIPE_TYPE_INT;
	zassert_equal(mpipe_ipc_msg_decode(&decoded, frame, one_field), -EPROTO);

	/* Channel layout is the mirror case: a boolean, and only a boolean. */
	(void)encode_one_field_caps(MPIPE_CAPS_INTERLEAVED,
				    (struct mpipe_value)MPIPE_VALUE_BOOLEAN(true));
	frame[9] = MPIPE_TYPE_UINT;
	zassert_equal(mpipe_ipc_msg_decode(&decoded, frame, one_field), -EPROTO);
}

/*
 * A structure sent as itself puts its padding on the wire, and padding holds
 * whatever the stack held before. Every byte of a frame here is one the encoder
 * chose to write.
 */
ZTEST(mpipe_ipc_msg, test_no_byte_of_a_frame_is_left_unwritten)
{
	struct mpipe_ipc_msg msg = {
		.type = MPIPE_IPC_MSG_CAPS,
		.caps = { .media_type_id = MPIPE_MEDIA_AUDIO_PCM, .num_fields = 1U },
	};
	size_t length;

	msg.caps.ids[0] = MPIPE_CAPS_SAMPLE_RATE;
	msg.caps.values[0] = (struct mpipe_value)MPIPE_VALUE_UINT(16000);

	length = encode(&msg);
	for (size_t i = 0; i < length; i++) {
		zassert_not_equal(frame[i], 0xaaU, "byte %zu was never written", i);
	}
	/* And nothing beyond the message was touched. */
	zassert_equal(frame[length], 0xaaU);
}

ZTEST(mpipe_ipc_msg, test_a_peer_speaking_another_version_is_refused)
{
	struct mpipe_ipc_msg msg = {
		.type = MPIPE_IPC_MSG_DATA_RELEASE,
		.release = { .buffer_id = 1U, .generation = 2U },
	};
	struct mpipe_ipc_msg decoded;

	(void)encode(&msg);
	frame[0] = MPIPE_IPC_PLUGIN_VERSION + 1U;
	zassert_equal(mpipe_ipc_msg_decode(&decoded, frame, RELEASE_LEN), -ENOTSUP);

	frame[0] = MPIPE_IPC_PLUGIN_VERSION - 1U;
	zassert_equal(mpipe_ipc_msg_decode(&decoded, frame, RELEASE_LEN), -ENOTSUP);
}

ZTEST(mpipe_ipc_msg, test_reserved_bytes_must_be_zero)
{
	struct mpipe_ipc_msg event = {
		.type = MPIPE_IPC_MSG_EVENT,
		.event = { .event_type = MPIPE_DISPATCH_EOS },
	};
	struct mpipe_ipc_msg decoded;

	(void)encode(&event);
	frame[2] = 1U;
	zassert_equal(mpipe_ipc_msg_decode(&decoded, frame, EVENT_LEN), -EPROTO,
		      "a nonzero header reserved byte was accepted");

	(void)encode(&event);
	frame[7] = 1U;
	zassert_equal(mpipe_ipc_msg_decode(&decoded, frame, EVENT_LEN), -EPROTO,
		      "a nonzero event reserved byte was accepted");

	(void)encode_one_field_caps(MPIPE_CAPS_SAMPLE_RATE,
				    (struct mpipe_value)MPIPE_VALUE_UINT(16000));
	frame[8U + 2U] = 1U;
	zassert_equal(mpipe_ipc_msg_decode(&decoded, frame,
					   8U + MPIPE_IPC_WIRE_FIELD_LEN),
		      -EPROTO, "a nonzero field reserved byte was accepted");
}

ZTEST(mpipe_ipc_msg, test_each_type_has_exactly_one_length)
{
	struct mpipe_ipc_msg msg = {
		.type = MPIPE_IPC_MSG_DATA_BUFFER,
		.data = { .offset = 0U, .size = 4U, .buffer_id = 0U, .generation = 1U },
	};
	struct mpipe_ipc_msg decoded;

	(void)encode(&msg);
	zassert_equal(mpipe_ipc_msg_decode(&decoded, frame, DATA_LEN - 1U), -EMSGSIZE);
	zassert_equal(mpipe_ipc_msg_decode(&decoded, frame, DATA_LEN + 1U), -EMSGSIZE);
	zassert_equal(mpipe_ipc_msg_decode(&decoded, frame, 0U), -EMSGSIZE);
	zassert_ok(mpipe_ipc_msg_decode(&decoded, frame, DATA_LEN));
}

ZTEST(mpipe_ipc_msg, test_an_unknown_message_type_is_refused)
{
	struct mpipe_ipc_msg msg = {
		.type = MPIPE_IPC_MSG_DATA_RELEASE,
		.release = { .buffer_id = 1U, .generation = 2U },
	};
	struct mpipe_ipc_msg decoded;
	size_t written;

	(void)encode(&msg);
	frame[1] = MPIPE_IPC_MSG_END;
	zassert_equal(mpipe_ipc_msg_decode(&decoded, frame, RELEASE_LEN), -ENOTSUP);

	msg.type = MPIPE_IPC_MSG_END;
	zassert_equal(mpipe_ipc_msg_encode(frame, sizeof(frame), &msg, &written), -EINVAL);
}

/* EOS is the only event the link carries; see the encoder. */
ZTEST(mpipe_ipc_msg, test_only_end_of_stream_crosses_as_an_event)
{
	struct mpipe_ipc_msg msg = {
		.type = MPIPE_IPC_MSG_EVENT,
		.event = { .event_type = MPIPE_DISPATCH_CAPS },
	};
	struct mpipe_ipc_msg decoded;
	size_t written;

	zassert_equal(mpipe_ipc_msg_encode(frame, sizeof(frame), &msg, &written), -EINVAL);

	msg.event.event_type = MPIPE_DISPATCH_EOS;
	(void)encode(&msg);
	frame[4] = MPIPE_DISPATCH_BUFFER_POOL;
	zassert_equal(mpipe_ipc_msg_decode(&decoded, frame, EVENT_LEN), -EPROTO);
}

ZTEST(mpipe_ipc_msg, test_a_caps_that_does_not_name_one_format_is_refused)
{
	struct mpipe_ipc_msg decoded;
	size_t one_field = 8U + MPIPE_IPC_WIRE_FIELD_LEN;
	size_t length;

	/* A field belonging to another medium. */
	length = encode_one_field_caps(MPIPE_CAPS_SAMPLE_RATE,
				       (struct mpipe_value)MPIPE_VALUE_UINT(16000));
	frame[8] = MPIPE_CAPS_IMAGE_WIDTH;
	zassert_equal(mpipe_ipc_msg_decode(&decoded, frame, length), -EPROTO);

	/* A field identifier that does not exist. */
	(void)encode_one_field_caps(MPIPE_CAPS_SAMPLE_RATE,
				    (struct mpipe_value)MPIPE_VALUE_UINT(16000));
	frame[8] = MPIPE_CAPS_END;
	zassert_equal(mpipe_ipc_msg_decode(&decoded, frame, one_field), -EPROTO);

	/* A value type that does not exist. */
	(void)encode_one_field_caps(MPIPE_CAPS_SAMPLE_RATE,
				    (struct mpipe_value)MPIPE_VALUE_UINT(16000));
	frame[9] = MPIPE_TYPE_COUNT;
	zassert_equal(mpipe_ipc_msg_decode(&decoded, frame, one_field), -EPROTO);

	/* A media type this build does not know. */
	(void)encode_one_field_caps(MPIPE_CAPS_SAMPLE_RATE,
				    (struct mpipe_value)MPIPE_VALUE_UINT(16000));
	frame[4] = MPIPE_MEDIA_END;
	zassert_equal(mpipe_ipc_msg_decode(&decoded, frame, one_field), -EPROTO);

	/* An undefined flag bit. */
	(void)encode_one_field_caps(MPIPE_CAPS_SAMPLE_RATE,
				    (struct mpipe_value)MPIPE_VALUE_UINT(16000));
	frame[5] = BIT(7);
	zassert_equal(mpipe_ipc_msg_decode(&decoded, frame, one_field), -EPROTO);

	/* More fields than there are identifiers to fill them. */
	(void)encode_one_field_caps(MPIPE_CAPS_SAMPLE_RATE,
				    (struct mpipe_value)MPIPE_VALUE_UINT(16000));
	frame[6] = MPIPE_IPC_WIRE_MAX_CAPS_FIELDS + 1U;
	zassert_equal(mpipe_ipc_msg_decode(&decoded, frame, one_field), -EPROTO);
}

ZTEST(mpipe_ipc_msg, test_a_value_outside_its_own_rules_is_refused)
{
	size_t one_field = 8U + MPIPE_IPC_WIRE_FIELD_LEN;
	struct mpipe_ipc_msg decoded;

	/* A scalar's unused words carry nothing but zero. */
	(void)encode_one_field_caps(MPIPE_CAPS_SAMPLE_RATE,
				    (struct mpipe_value)MPIPE_VALUE_UINT(16000));
	sys_put_le32(1U, &frame[8U + 8U]);
	zassert_equal(mpipe_ipc_msg_decode(&decoded, frame, one_field), -EPROTO);

	/* A range that runs backwards. */
	(void)encode_one_field_caps(MPIPE_CAPS_SAMPLE_RATE,
				    (struct mpipe_value)MPIPE_VALUE_UINT_RANGE(16000, 48000,
									       8000));
	sys_put_le32(48000U, &frame[8U + 4U]);
	sys_put_le32(16000U, &frame[8U + 8U]);
	zassert_equal(mpipe_ipc_msg_decode(&decoded, frame, one_field), -EPROTO);

	/* A range whose step is zero enumerates nothing. */
	(void)encode_one_field_caps(MPIPE_CAPS_SAMPLE_RATE,
				    (struct mpipe_value)MPIPE_VALUE_UINT_RANGE(16000, 48000,
									       8000));
	sys_put_le32(0U, &frame[8U + 12U]);
	zassert_equal(mpipe_ipc_msg_decode(&decoded, frame, one_field), -EPROTO);

	/* Channel layout is a boolean, and a boolean is zero or one. */
	(void)encode_one_field_caps(MPIPE_CAPS_INTERLEAVED,
				    (struct mpipe_value)MPIPE_VALUE_BOOLEAN(true));
	sys_put_le32(2U, &frame[8U + 4U]);
	zassert_equal(mpipe_ipc_msg_decode(&decoded, frame, one_field), -EPROTO);

}

ZTEST(mpipe_ipc_msg, test_any_and_unknown_are_statements_about_nothing)
{
	struct mpipe_ipc_msg msg = {
		.type = MPIPE_IPC_MSG_CAPS,
		.caps = {
			.media_type_id = MPIPE_MEDIA_UNKNOWN,
			.flags = MPIPE_STRUCTURE_FLAG_ANY,
		},
	};
	struct mpipe_ipc_msg decoded;
	size_t length = encode(&msg);

	zassert_ok(mpipe_ipc_msg_decode(&decoded, frame, length),
		   "'any format' is a format a peer may announce");
	zassert_equal(decoded.caps.flags, MPIPE_STRUCTURE_FLAG_ANY);

	/* But not "any format, which is PCM". */
	frame[4] = MPIPE_MEDIA_AUDIO_PCM;
	zassert_equal(mpipe_ipc_msg_decode(&decoded, frame, length), -EPROTO);

	/* Nor a medium-less structure that carries fields anyway. */
	(void)encode_one_field_caps(MPIPE_CAPS_SAMPLE_RATE,
				    (struct mpipe_value)MPIPE_VALUE_UINT(16000));
	frame[4] = MPIPE_MEDIA_UNKNOWN;
	zassert_equal(mpipe_ipc_msg_decode(&decoded, frame,
					   8U + MPIPE_IPC_WIRE_FIELD_LEN),
		      -EPROTO);
}

ZTEST(mpipe_ipc_msg, test_argument_rules)
{
	struct mpipe_ipc_msg msg = {
		.type = MPIPE_IPC_MSG_DATA_RELEASE,
		.release = { .buffer_id = 0U, .generation = 1U },
	};
	struct mpipe_ipc_msg decoded;
	size_t written;

	zassert_equal(mpipe_ipc_msg_encode(NULL, sizeof(frame), &msg, &written), -EINVAL);
	zassert_equal(mpipe_ipc_msg_encode(frame, sizeof(frame), NULL, &written), -EINVAL);
	zassert_equal(mpipe_ipc_msg_encode(frame, sizeof(frame), &msg, NULL), -EINVAL);
	zassert_equal(mpipe_ipc_msg_encode(frame, RELEASE_LEN - 1U, &msg, &written), -ENOSPC);
	zassert_ok(mpipe_ipc_msg_encode(frame, RELEASE_LEN, &msg, &written));

	zassert_equal(mpipe_ipc_msg_decode(NULL, frame, RELEASE_LEN), -EINVAL);
	zassert_equal(mpipe_ipc_msg_decode(&decoded, NULL, RELEASE_LEN), -EINVAL);
}

/*
 * A CAPS frame states its own field count, in a byte four bytes past the
 * header. A frame that stops before that byte has to be refused on its length
 * alone: deciding how long the frame should be by reading the count first
 * reads a byte the peer never sent.
 *
 * The truncated copy is what makes that a real test rather than a restatement.
 * Decoding a short length out of the full frame would still find the encoder's
 * own header bytes sitting there, and every path would agree. Here the bytes
 * past the cut belong to nobody.
 */
ZTEST(mpipe_ipc_msg, test_a_caps_shorter_than_its_own_header_is_refused)
{
	struct mpipe_ipc_msg msg = {
		.type = MPIPE_IPC_MSG_CAPS,
		.caps = { .media_type_id = MPIPE_MEDIA_AUDIO_PCM, .num_fields = 1U },
	};
	struct mpipe_ipc_msg decoded;
	size_t length;

	msg.caps.ids[0] = MPIPE_CAPS_SAMPLE_RATE;
	msg.caps.values[0] = (struct mpipe_value)MPIPE_VALUE_UINT(16000);
	length = encode(&msg);

	for (size_t truncated = MPIPE_IPC_WIRE_HEADER_LEN; truncated < length; truncated++) {
		uint8_t received[MPIPE_IPC_WIRE_MAX_LEN];

		memset(received, 0xbb, sizeof(received));
		memcpy(received, frame, truncated);

		zassert_equal(mpipe_ipc_msg_decode(&decoded, received, truncated), -EMSGSIZE,
			      "a %zu-byte CAPS was accepted", truncated);
	}

	zassert_ok(mpipe_ipc_msg_decode(&decoded, frame, length));
}

/*
 * The compatibility case the format exists for. CONFIG_MPIPE_STRUCTURE_MAX_FIELDS
 * is a local storage choice, and the peer's copy of it is unknowable. A peer
 * built with more room than this one can legally put more fields on the wire
 * than this one can hold -- the format's own ceiling is the number of field
 * identifiers that exist, not anybody's Kconfig -- and that must come back as a
 * refusal, not as a structure filled in past its end.
 */
ZTEST(mpipe_ipc_msg, test_a_peer_with_more_field_slots_is_refused_not_misparsed)
{
	const uint8_t over = CONFIG_MPIPE_STRUCTURE_MAX_FIELDS + 1U;
	struct mpipe_ipc_msg decoded;
	size_t length;

	zassert_true(over <= MPIPE_IPC_WIRE_MAX_CAPS_FIELDS,
		     "this test needs a field count the wire allows but we cannot hold");

	/* Built by hand: a structure this build can hold cannot express it. */
	memset(frame, 0, sizeof(frame));
	frame[0] = MPIPE_IPC_PLUGIN_VERSION;
	frame[1] = MPIPE_IPC_MSG_CAPS;
	frame[4] = MPIPE_MEDIA_AUDIO_PCM;
	frame[6] = over;

	/*
	 * Every record is a well-formed one. The count is refused before any of
	 * them is read, which is the property being tested: a structure that
	 * cannot be held is never partly filled in first.
	 */
	for (uint8_t i = 0; i < over; i++) {
		uint8_t *field = &frame[8U + ((size_t)i * MPIPE_IPC_WIRE_FIELD_LEN)];

		field[0] = MPIPE_CAPS_SAMPLE_RATE;
		field[1] = MPIPE_TYPE_UINT;
		sys_put_le32(16000U, &field[4]);
	}
	length = 8U + ((size_t)over * MPIPE_IPC_WIRE_FIELD_LEN);

	zassert_equal(mpipe_ipc_msg_decode(&decoded, frame, length), -EPROTO,
		      "a peer with more field slots was misparsed");
}
```

## src/test_ring.c
```c
/*
 * Copyright 2026 NXP
 *
 * SPDX-License-Identifier: Apache-2.0
 */

#include <zephyr/ztest.h>
#include <string.h>

#include <zephyr/mpipe/ipc/mpipe_ipc_ring.h>

ZTEST_SUITE(mpipe_ipc_ring, NULL, NULL, NULL, NULL, NULL);

#define PERIOD_BYTES 64U
#define PERIOD_COUNT 4U
#define REGION_SIZE  (MPIPE_IPC_RING_DATA_OFFSET + (PERIOD_BYTES * PERIOD_COUNT))

/*
 * Both sides are driven against one region, because the property worth testing
 * is that a producer and a consumer agree -- which cannot be observed from
 * either one alone.
 */
static uint8_t region[REGION_SIZE] __aligned(4);

static uint32_t fake_load(const volatile uint32_t *address)
{
	return *address;
}

static void fake_store(volatile uint32_t *address, uint32_t value)
{
	*address = value;
}

static const struct mpipe_ipc_ring_ops ops = {
	.load = fake_load,
	.store = fake_store,
};

static volatile struct mpipe_ipc_ring_shared *shared(void)
{
	return (volatile struct mpipe_ipc_ring_shared *)region;
}

static void reset_region(void)
{
	memset(region, 0, sizeof(region));
}

/* Write one period whose every byte is `tag`. */
static void produce_tagged(struct mpipe_ipc_ring *p, uint8_t tag)
{
	void *slot = mpipe_ipc_ring_claim_write(p);

	zassert_not_null(slot);
	memset(slot, tag, PERIOD_BYTES);
	zassert_ok(mpipe_ipc_ring_commit_write(p));
}

/* Read one period and assert every byte is `tag`. */
static void consume_expecting(struct mpipe_ipc_ring *c, uint8_t tag)
{
	const uint8_t *slot = mpipe_ipc_ring_claim_read(c);

	zassert_not_null(slot);
	for (size_t i = 0; i < PERIOD_BYTES; i++) {
		zassert_equal(slot[i], tag, "byte %zu of the period is wrong", i);
	}
	zassert_ok(mpipe_ipc_ring_commit_read(c));
}

static void open_pair(struct mpipe_ipc_ring *p, struct mpipe_ipc_ring *c)
{
	reset_region();
	zassert_ok(mpipe_ipc_ring_init(p, shared(), &ops, true, PERIOD_BYTES,
				       PERIOD_COUNT, REGION_SIZE));
	zassert_ok(mpipe_ipc_ring_init(c, shared(), &ops, false, PERIOD_BYTES,
				       PERIOD_COUNT, REGION_SIZE));
}

ZTEST(mpipe_ipc_ring, test_a_period_arrives_intact)
{
	struct mpipe_ipc_ring producer, consumer;

	open_pair(&producer, &consumer);

	zassert_equal(mpipe_ipc_ring_fill(&consumer), 0U);
	zassert_equal(mpipe_ipc_ring_space(&producer), PERIOD_COUNT);

	produce_tagged(&producer, 0xa5);
	zassert_equal(mpipe_ipc_ring_fill(&consumer), 1U,
		      "the consumer sees the period as soon as it is committed");

	consume_expecting(&consumer, 0xa5);
	zassert_equal(mpipe_ipc_ring_fill(&consumer), 0U);
	zassert_equal(mpipe_ipc_ring_space(&producer), PERIOD_COUNT);
}

ZTEST(mpipe_ipc_ring, test_nothing_is_visible_before_the_commit)
{
	struct mpipe_ipc_ring producer, consumer;
	void *slot;

	open_pair(&producer, &consumer);

	slot = mpipe_ipc_ring_claim_write(&producer);
	zassert_not_null(slot);
	memset(slot, 0x5a, PERIOD_BYTES);

	zassert_equal(mpipe_ipc_ring_fill(&consumer), 0U,
		      "a claimed but uncommitted period must not be readable");
	zassert_is_null(mpipe_ipc_ring_claim_read(&consumer));

	zassert_ok(mpipe_ipc_ring_commit_write(&producer));
	zassert_equal(mpipe_ipc_ring_fill(&consumer), 1U);
}

ZTEST(mpipe_ipc_ring, test_the_ring_fills_and_refuses_to_overwrite)
{
	struct mpipe_ipc_ring producer, consumer;

	open_pair(&producer, &consumer);

	for (uint8_t i = 0; i < PERIOD_COUNT; i++) {
		produce_tagged(&producer, (uint8_t)(0x10 + i));
	}

	zassert_equal(mpipe_ipc_ring_space(&producer), 0U);
	zassert_is_null(mpipe_ipc_ring_claim_write(&producer),
			"a full ring must not hand out a slot the consumer still owns");

	mpipe_ipc_ring_record_overrun(&producer);
	zassert_equal(shared()->producer.overruns, 1U);

	/* Freeing one slot admits exactly one more period. */
	consume_expecting(&consumer, 0x10);
	zassert_equal(mpipe_ipc_ring_space(&producer), 1U);
	produce_tagged(&producer, 0x20);
	zassert_equal(mpipe_ipc_ring_space(&producer), 0U);
}

ZTEST(mpipe_ipc_ring, test_an_empty_ring_yields_nothing)
{
	struct mpipe_ipc_ring producer, consumer;

	open_pair(&producer, &consumer);

	zassert_is_null(mpipe_ipc_ring_claim_read(&consumer));
	mpipe_ipc_ring_record_underrun(&consumer);
	zassert_equal(shared()->consumer.underruns, 1U);
	zassert_equal(mpipe_ipc_ring_commit_read(&consumer), -EINVAL,
		      "committing without a claim is a caller error");
}

/*
 * The counters are monotonic and 32 bits wide, so they wrap long before any
 * realistic stream ends -- at 10 ms periods, after about 16 months. Fill is a
 * subtraction precisely so that the wrap is not a special case.
 */
ZTEST(mpipe_ipc_ring, test_the_sequence_wrap_is_not_a_special_case)
{
	struct mpipe_ipc_ring producer, consumer;

	open_pair(&producer, &consumer);

	/* Park both sides three periods short of the wrap. */
	producer.sequence = UINT32_MAX - 2U;
	consumer.sequence = UINT32_MAX - 2U;
	fake_store(&shared()->producer.sequence, producer.sequence);
	fake_store(&shared()->consumer.sequence, consumer.sequence);

	zassert_equal(mpipe_ipc_ring_fill(&consumer), 0U);
	zassert_equal(mpipe_ipc_ring_space(&producer), PERIOD_COUNT);

	/* Walk across the wrap, checking the data survives the slot mapping. */
	for (uint8_t i = 0; i < 8U; i++) {
		produce_tagged(&producer, (uint8_t)(0x80 + i));
		zassert_equal(mpipe_ipc_ring_fill(&consumer), 1U);
		consume_expecting(&consumer, (uint8_t)(0x80 + i));
		zassert_equal(mpipe_ipc_ring_fill(&consumer), 0U);
	}

	zassert_true(producer.sequence < 8U, "the counter really did wrap");
}

/*
 * A geometry mismatch is silent in hardware: each side simply addresses
 * different bytes than the other wrote. The same class of silent disagreement
 * in the mailbox channel mapping cost a long debugging session on this link, so
 * the consumer checks rather than assumes.
 */
ZTEST(mpipe_ipc_ring, test_a_consumer_refuses_a_geometry_it_does_not_share)
{
	struct mpipe_ipc_ring producer, consumer;

	reset_region();
	zassert_ok(mpipe_ipc_ring_init(&producer, shared(), &ops, true, PERIOD_BYTES,
				       PERIOD_COUNT, REGION_SIZE));

	/*
	 * Both geometries below fit the region, so nothing local rejects them.
	 * Only the comparison against what the producer published does -- which
	 * is the whole point: a mismatch that fits is the one that stays silent.
	 */
	zassert_equal(mpipe_ipc_ring_init(&consumer, shared(), &ops, false,
					  PERIOD_BYTES * 2U, PERIOD_COUNT / 2U,
					  REGION_SIZE),
		      -EPROTO, "a different period size must not be accepted");
	zassert_equal(mpipe_ipc_ring_init(&consumer, shared(), &ops, false, PERIOD_BYTES,
					  PERIOD_COUNT - 1U, REGION_SIZE),
		      -EPROTO, "nor a different period count");

	zassert_ok(mpipe_ipc_ring_init(&consumer, shared(), &ops, false, PERIOD_BYTES,
				       PERIOD_COUNT, REGION_SIZE));
}

ZTEST(mpipe_ipc_ring, test_a_consumer_waits_for_a_producer)
{
	struct mpipe_ipc_ring consumer;

	reset_region();
	zassert_equal(mpipe_ipc_ring_init(&consumer, shared(), &ops, false, PERIOD_BYTES,
					  PERIOD_COUNT, REGION_SIZE),
		      -EAGAIN, "no geometry published yet means no stream yet");
}

/* A consumer that arrives late joins the stream rather than replaying it. */
ZTEST(mpipe_ipc_ring, test_a_late_consumer_joins_where_the_producer_is)
{
	struct mpipe_ipc_ring producer, consumer;

	reset_region();
	zassert_ok(mpipe_ipc_ring_init(&producer, shared(), &ops, true, PERIOD_BYTES,
				       PERIOD_COUNT, REGION_SIZE));

	produce_tagged(&producer, 0x11);
	produce_tagged(&producer, 0x22);

	zassert_ok(mpipe_ipc_ring_init(&consumer, shared(), &ops, false, PERIOD_BYTES,
				       PERIOD_COUNT, REGION_SIZE));
	zassert_equal(mpipe_ipc_ring_fill(&consumer), 0U,
		      "stale periods from before the consumer existed are not audio");

	produce_tagged(&producer, 0x33);
	consume_expecting(&consumer, 0x33);
}

ZTEST(mpipe_ipc_ring, test_geometry_must_fit_the_region)
{
	struct mpipe_ipc_ring producer;

	reset_region();
	zassert_equal(mpipe_ipc_ring_capacity(REGION_SIZE, PERIOD_BYTES), PERIOD_COUNT);
	zassert_equal(mpipe_ipc_ring_capacity(MPIPE_IPC_RING_DATA_OFFSET, PERIOD_BYTES),
		      0U, "a region with no room for data holds no periods");

	zassert_equal(mpipe_ipc_ring_init(&producer, shared(), &ops, true, PERIOD_BYTES,
					  PERIOD_COUNT + 1U, REGION_SIZE),
		      -ENOSPC);
	zassert_equal(mpipe_ipc_ring_init(&producer, shared(), &ops, true, 0U,
					  PERIOD_COUNT, REGION_SIZE),
		      -EINVAL);
	zassert_equal(mpipe_ipc_ring_init(NULL, shared(), &ops, true, PERIOD_BYTES,
					  PERIOD_COUNT, REGION_SIZE),
		      -EINVAL);
}

ZTEST(mpipe_ipc_ring, test_roles_are_enforced)
{
	struct mpipe_ipc_ring producer, consumer;

	open_pair(&producer, &consumer);

	zassert_is_null(mpipe_ipc_ring_claim_read(&producer),
			"a producer must not consume");
	zassert_is_null(mpipe_ipc_ring_claim_write(&consumer),
			"a consumer must not produce");
	zassert_equal(mpipe_ipc_ring_commit_write(&consumer), -EINVAL);
	zassert_equal(mpipe_ipc_ring_commit_read(&producer), -EINVAL);

	/* A second claim without a commit is a caller error, not a new slot. */
	zassert_not_null(mpipe_ipc_ring_claim_write(&producer));
	zassert_is_null(mpipe_ipc_ring_claim_write(&producer));
}
```
