## CMakeLists.txt
```
# Copyright 2026 NXP
# SPDX-License-Identifier: Apache-2.0

cmake_minimum_required(VERSION 3.20.0)
find_package(Zephyr REQUIRED HINTS $ENV{ZEPHYR_BASE})
project(mpipe_aud_latency_test)

target_sources(app PRIVATE src/test_latency.c src/test_probe.c src/test_prime.c)
target_include_directories(app PRIVATE ${ZEPHYR_BASE}/subsys/mpipe/aud)
```

## Kconfig
```
# Copyright 2026 NXP
# SPDX-License-Identifier: Apache-2.0

mainmenu "mpipe audio latency tests"

source "Kconfig.zephyr"

config TEST_MPIPE_PRIME_TOO_DEEP
	bool "Expect silence-prime negotiation rejection"
```

## prj.conf
```kconfig
CONFIG_ZTEST=y
CONFIG_MPIPE_LATENCY=y
CONFIG_LOG=y

CONFIG_MPIPE=y
CONFIG_MPIPE_BASE=y
CONFIG_MPIPE_BASE_CAPS_FILTER=y
CONFIG_MPIPE_AUD=y
CONFIG_MPIPE_AUD_I2S_CODEC_SINK_SILENCE_PRIME=y
CONFIG_ZBUS=y
CONFIG_ZBUS_MSG_SUBSCRIBER=y

CONFIG_I2S=y
CONFIG_I2S_NATIVE_SIM_QUEUE_SIZE=3
CONFIG_AUDIO=y
CONFIG_AUDIO_CODEC=y

CONFIG_MAIN_STACK_SIZE=8192
```

## src/test_latency.c
```c
/*
 * Copyright 2026 NXP
 *
 * SPDX-License-Identifier: Apache-2.0
 */

#include <zephyr/ztest.h>
#include <zephyr/kernel.h>

#include <zephyr/mpipe/mpipe.h>
#include <zephyr/mpipe/mpipe_bin.h>
#include <zephyr/mpipe/mpipe_element.h>
#include <zephyr/mpipe/mpipe_latency.h>
#include <zephyr/mpipe/mpipe_pipeline.h>
#include <zephyr/mpipe/mpipe_structure.h>
#include <zephyr/mpipe/aud/mpipe_aud.h>
#include <zephyr/mpipe/aud/mpipe_aud_i2s_codec_sink.h>
#include <zephyr/mpipe/aud/mpipe_aud_i2s_src.h>
#include <zephyr/mpipe/aud/mpipe_aud_src.h>
#include <zephyr/mpipe/base/mpipe_caps_filter.h>

#define FRAME_INTERVAL_US 10000U
/* Long enough to exercise the running pipeline beyond the earlier 320 ms claim. */
#define RUN_MS 400

__nocache struct k_mem_slab test_slab;

static struct mpipe pipe;
static struct mpipe_aud_i2s_src src;
static struct mpipe_aud_i2s_codec_sink sink;
static struct mpipe_caps_filter caps_filter;

/*
 * The elements are static and linking them is a one-shot operation, so the
 * graph is built and run once for the whole suite and every test reads the
 * snapshot it produced. That also keeps the tests independent of the order
 * ztest happens to run them in.
 */
static struct mpipe_latency_stats g_transit;
static struct mpipe_latency_occupancy_stats g_occ;

static void run_pipeline(void)
{
	struct mpipe_structure caps;
	enum mpipe_state_change_return state_ret;

	zassert_ok(mpipe_pipeline_init(&pipe, 0));
	zassert_ok(mpipe_aud_i2s_src_init(&src, 1, DEVICE_DT_GET(DT_ALIAS(i2s_codec_rx))));
	zassert_ok(mpipe_caps_filter_init(&caps_filter, 2));
	zassert_ok(mpipe_aud_i2s_codec_sink_init(&sink, 3));

	zassert_ok(mpipe_object_set_properties((struct mpipe_object *)&src,
					       MPIPE_PROP_AUD_SRC_SLAB_PTR, &test_slab,
					       MPIPE_PROP_LIST_END));
	zassert_ok(mpipe_object_set_properties((struct mpipe_object *)&sink,
					       MPIPE_PROP_AUD_SINK_SLAB_PTR, &test_slab,
					       MPIPE_PROP_LIST_END));

	zassert_ok(mpipe_structure_init_fields(&caps, MPIPE_MEDIA_AUDIO_PCM,
					       MPIPE_CAPS_FRAME_INTERVAL, MPIPE_TYPE_UINT,
					       FRAME_INTERVAL_US, MPIPE_CAPS_NUM_OF_CHANNEL,
					       MPIPE_TYPE_UINT, 2, MPIPE_CAPS_END));
	zassert_ok(mpipe_object_set_properties((struct mpipe_object *)&caps_filter,
					       MPIPE_PROP_BASE_CAPS_FILTER_CAPS, &caps,
					       MPIPE_PROP_LIST_END));

	zassert_ok(mpipe_element_link((struct mpipe_element *)&src,
				      (struct mpipe_element *)&caps_filter,
				      (struct mpipe_element *)&sink, NULL));
	zassert_ok(mpipe_bin_add((struct mpipe_bin *)&pipe, (struct mpipe_element *)&src,
				 (struct mpipe_element *)&caps_filter,
				 (struct mpipe_element *)&sink, NULL));

	mpipe_latency_reset();

	state_ret = mpipe_element_set_state((struct mpipe_element *)&pipe, MPIPE_STATE_PLAYING);
#if defined(CONFIG_TEST_MPIPE_PRIME_TOO_DEEP)
	zassert_equal(state_ret, MPIPE_STATE_CHANGE_FAILURE,
		      "oversized silence prime was accepted");
	return;
#else
	zassert_equal(state_ret, MPIPE_STATE_CHANGE_SUCCESS, "pipeline did not enter PLAYING");
#endif
	k_msleep(RUN_MS);
	/*
	 * Keep the pool intact while stopping capture. READY teardown and its
	 * required source guard are covered by Zephyr pull request 114262.
	 */
	zassert_equal(mpipe_element_set_state((struct mpipe_element *)&pipe, MPIPE_STATE_PAUSED),
		      MPIPE_STATE_CHANGE_SUCCESS);

	mpipe_latency_get_stats(&g_transit);
	mpipe_latency_occupancy_get_stats(&g_occ);
}

static void *latency_suite_setup(void)
{
	run_pipeline();
	return NULL;
}

#if defined(CONFIG_MPIPE_LATENCY)

#if !defined(CONFIG_TEST_MPIPE_PRIME_TOO_DEEP)

ZTEST(mpipe_aud_latency, test_transit_and_occupancy_are_measured)
{
	const struct mpipe_latency_stats transit = g_transit;
	const struct mpipe_latency_occupancy_stats occ = g_occ;

	zassert_true(transit.count > 0U, "no buffer reached the sink");
	zassert_true(transit.min_us <= transit.max_us, "transit min above max");
	zassert_true(transit.sum_us / transit.count <= transit.max_us, "mean above max");

	/* The audio pool answers get_occupancy, so occupancy must be sampled. */
	zassert_equal(occ.count, transit.count, "occupancy not sampled on every buffer");
	zassert_true(occ.capacity > 0U, "pool reported no capacity");
	zassert_true(occ.max_blocks <= occ.capacity, "more buffers in flight than the pool holds");
	zassert_true(occ.min_blocks <= occ.max_blocks, "occupancy min above max");
}

ZTEST(mpipe_aud_latency, test_measured_period_tracks_the_frame_interval)
{
	const struct mpipe_latency_occupancy_stats occ = g_occ;

	zassert_true(occ.count > 1U, "not enough buffers to measure an interval");

	/*
	 * native_sim does not pace this graph like physical audio hardware. This
	 * bound catches a missing or nonsensical interval; it does not prove that
	 * the value differs from the negotiated frame interval.
	 */
	zassert_true(occ.period_us < 10U * FRAME_INTERVAL_US,
		     "measured period %u us is implausible", occ.period_us);
}

ZTEST(mpipe_aud_latency, test_period_converts_after_accumulation)
{
	uint32_t one_us_cyc = k_us_to_cyc_floor32(1U);

	zassert_equal(mpipe_latency_mean_period_us((uint64_t)one_us_cyc * 3U, 3U), 1U,
		      "mean period conversion changed");
	zassert_equal(mpipe_latency_mean_period_us(100U, 0U), 0U,
		      "zero gaps must produce zero period");
}

ZTEST(mpipe_aud_latency, test_reset_clears_every_accumulator)
{
	struct mpipe_latency_stats transit;
	struct mpipe_latency_occupancy_stats occ;

	/* The suite already ran the graph, so there is something to clear. */
	mpipe_latency_reset();

	mpipe_latency_get_stats(&transit);
	mpipe_latency_occupancy_get_stats(&occ);

	zassert_equal(transit.count, 0U, "transit count survived a reset");
	zassert_equal(transit.min_us, 0U, "an empty accumulator must read 0, not UINT32_MAX");
	zassert_equal(occ.count, 0U, "occupancy count survived a reset");
	zassert_equal(occ.min_blocks, 0U, "an empty accumulator must read 0, not UINT32_MAX");
	zassert_equal(occ.period_us, 0U, "period survived a reset");
}

#else

ZTEST(mpipe_aud_latency, test_oversized_prime_prevents_measurement)
{
	zassert_equal(g_transit.count, 0U, "failed graph reported transit");
	zassert_equal(g_occ.count, 0U, "failed graph reported pool utilisation");
}

#endif /* CONFIG_TEST_MPIPE_PRIME_TOO_DEEP */

#else /* CONFIG_MPIPE_LATENCY */

ZTEST(mpipe_aud_latency, test_disabled_build_reports_nothing_and_still_runs)
{
	const struct mpipe_latency_stats transit = g_transit;
	const struct mpipe_latency_occupancy_stats occ = g_occ;

	/* The instrumented call sites compiled out, and the graph still ran. */
	zassert_equal(transit.count, 0U, "a disabled build reported transit");
	zassert_equal(occ.count, 0U, "a disabled build reported occupancy");
}

#endif /* CONFIG_MPIPE_LATENCY */

ZTEST_SUITE(mpipe_aud_latency, NULL, latency_suite_setup, NULL, NULL, NULL);
```

## src/test_prime.c
```c
/*
 * Copyright 2026 NXP
 *
 * SPDX-License-Identifier: Apache-2.0
 */

#include <zephyr/ztest.h>

#include "mpipe_aud_i2s_codec_sink_internal.h"

ZTEST(mpipe_aud_latency, test_silence_prime_bounds)
{
	zassert_ok(mpipe_aud_i2s_codec_sink_validate_prime(2U, 3U));
	zassert_ok(mpipe_aud_i2s_codec_sink_validate_prime(3U, 3U));
	zassert_ok(mpipe_aud_i2s_codec_sink_validate_prime(3U, 0U));
	zassert_equal(mpipe_aud_i2s_codec_sink_validate_prime(1U, 3U), -EINVAL,
		      "known-starving prime was accepted");
	zassert_equal(mpipe_aud_i2s_codec_sink_validate_prime(4U, 3U), -ENOBUFS,
		      "prime above queue capacity was accepted");
}
```

## src/test_probe.c
```c
/*
 * Copyright 2026 NXP
 *
 * SPDX-License-Identifier: Apache-2.0
 */

#include <string.h>

#include <zephyr/ztest.h>

#include <zephyr/mpipe/aud/mpipe_aud_loopback_probe.h>

#define QUIET_CALLS 100U

#if defined(CONFIG_MPIPE_AUD_LOOPBACK_PROBE)

ZTEST(mpipe_aud_latency, test_probe_rejects_invalid_width)
{
	zassert_equal(mpipe_aud_loopback_arm(8U, 4U), -EINVAL,
		      "8-bit probe width was accepted");
	zassert_equal(mpipe_aud_loopback_arm(24U, 4U), -EINVAL,
		      "24-bit probe width was accepted");
}

ZTEST(mpipe_aud_latency, test_probe_detects_returned_burst)
{
	int16_t buffer[32] = {0};
	struct mpipe_aud_loopback_result result;
	struct mpipe_aud_loopback_result after_done;

	zassert_ok(mpipe_aud_loopback_arm(16U, 4U));
	for (uint32_t i = 0U; i < QUIET_CALLS; i++) {
		mpipe_aud_loopback_emit(buffer, sizeof(buffer));
	}
	mpipe_aud_loopback_emit(buffer, sizeof(buffer));
	mpipe_aud_loopback_detect(buffer, sizeof(buffer));
	mpipe_aud_loopback_get(&result);

	zassert_true(result.valid, "returned burst was not detected");
	zassert_false(result.timed_out, "successful probe reported timeout");
	zassert_false(result.pending, "successful probe remained pending");
	zassert_equal(result.hit_index, 0U, "wrong first matching sample");

	memset(buffer, 0x7f, sizeof(buffer));
	mpipe_aud_loopback_detect(buffer, sizeof(buffer));
	mpipe_aud_loopback_get(&after_done);
	zassert_equal(after_done.noise_floor, result.noise_floor,
		      "DONE state kept scanning capture");

	zassert_ok(mpipe_aud_loopback_arm(16U, 4U));
	mpipe_aud_loopback_get(&after_done);
	zassert_false(after_done.valid, "rearm retained successful result");
	zassert_false(after_done.timed_out, "rearm invented timeout");
}

ZTEST(mpipe_aud_latency, test_probe_timeout_restores_audio)
{
	int16_t buffer[32];
	int16_t expected[32];
	struct mpipe_aud_loopback_result result;

	zassert_ok(mpipe_aud_loopback_arm(16U, UINT16_MAX));
	memset(buffer, 0x2a, sizeof(buffer));
	for (uint32_t i = 0U; i < QUIET_CALLS + 1U; i++) {
		mpipe_aud_loopback_emit(buffer, sizeof(buffer));
	}
	for (uint32_t i = 0U; i < 256U; i++) {
		memset(buffer, 0x2a, sizeof(buffer));
		mpipe_aud_loopback_emit(buffer, sizeof(buffer));
		mpipe_aud_loopback_get(&result);
		if (result.timed_out) {
			break;
		}
	}

	zassert_true(result.timed_out, "missing return never timed out");
	zassert_false(result.valid, "timeout reported a valid measurement");
	zassert_false(result.pending, "timeout remained pending");

	memset(buffer, 0x2a, sizeof(buffer));
	memcpy(expected, buffer, sizeof(buffer));
	mpipe_aud_loopback_emit(buffer, sizeof(buffer));
	zassert_mem_equal(buffer, expected, sizeof(buffer),
			  "probe kept muting after timeout");

	zassert_ok(mpipe_aud_loopback_arm(16U, 4U));
	mpipe_aud_loopback_get(&result);
	zassert_false(result.valid, "rearm retained timeout as success");
	zassert_false(result.timed_out, "rearm retained timeout result");
}

#else

ZTEST(mpipe_aud_latency, test_disabled_probe_stubs_are_inert)
{
	int16_t buffer[4] = {1, 2, 3, 4};
	const int16_t expected[4] = {1, 2, 3, 4};
	struct mpipe_aud_loopback_result result = {.valid = true, .timed_out = true};

	zassert_equal(mpipe_aud_loopback_arm(16U, 4U), -ENOSYS,
		      "disabled arm did not report unsupported operation");
	mpipe_aud_loopback_emit(buffer, sizeof(buffer));
	mpipe_aud_loopback_detect(buffer, sizeof(buffer));
	mpipe_aud_loopback_get(&result);
	zassert_mem_equal(buffer, expected, sizeof(buffer),
			  "disabled probe modified audio");
	zassert_false(result.valid, "disabled get retained a valid result");
	zassert_false(result.timed_out, "disabled get retained a timeout");
}

#endif
```
