## tests/drivers/i2s/i2s_api/boards/imx8mp_evk_mimx8ml8_m7_ddr.conf
```kconfig
CONFIG_CLOCK_CONTROL_FIXED_RATE_CLOCK=y
CONFIG_IMX8M_M7_AUDIOMIX_BOOT_HANDOFF=y
CONFIG_UART_CONSOLE=n
CONFIG_UART_INTERRUPT_DRIVEN=n
```

## tests/drivers/i2s/i2s_api/boards/native_sim_mcux_mixed.conf
```kconfig
CONFIG_I2S_MCUX_SAI=n
CONFIG_DMA_MCUX_EDMA=n
CONFIG_DMA_MCUX_EDMA_V3=n
CONFIG_DMA_MCUX_EDMA_V4=n
CONFIG_DMA_NXP_SDMA=n
```
