## CMakeLists.txt
```
# SPDX-License-Identifier: Apache-2.0

cmake_minimum_required(VERSION 3.28.0)

find_package(Zephyr REQUIRED HINTS $ENV{ZEPHYR_BASE})
project(imx8m_audio_clock)

target_sources(app PRIVATE src/main.c)

if(CONFIG_IMX8M_M7_AUDIO_PLL1)
  set(audio_clock_owner owned)
else()
  set(audio_clock_owner external)
endif()

# The expected AUDIOMIX attachments follow the active devicetree nodes, so the
# same verifier covers the combined, SAI-only, and PDM-only configurations.
set(audio_clock_attachments "")
foreach(node sai3 micfil)
  dt_nodelabel(node_path NODELABEL "${node}")
  if(node_path)
    dt_node_has_status(node_okay PATH "${node_path}" STATUS okay)
    if(node_okay)
      list(APPEND audio_clock_attachments "${node}")
    endif()
  endif()
endforeach()
list(JOIN audio_clock_attachments "," audio_clock_attach_arg)
```

## prj.conf
```kconfig
CONFIG_CLOCK_CONTROL=y
CONFIG_CLOCK_CONTROL_FIXED_RATE_CLOCK=y
CONFIG_DAI=y
CONFIG_IMX8M_M7_AUDIOMIX_BOOT_HANDOFF=y
CONFIG_SERIAL=n
CONFIG_UART_CONSOLE=n
CONFIG_UART_INTERRUPT_DRIVEN=n
```

## src/main.c
```c
/*
 * Copyright 2026 NXP
 *
 * SPDX-License-Identifier: Apache-2.0
 */

#include <zephyr/devicetree.h>
#include <zephyr/dt-bindings/clock/imx_ccm.h>
#include <zephyr/kernel.h>

/*
 * Each active audio peripheral must name the CCM provider together with the
 * clock it owns. The AUDIOMIX attachment identities are asserted in soc.c, so
 * they are covered by every build of this SoC and not only by this fixture.
 */

#if DT_NODE_HAS_STATUS_OKAY(DT_NODELABEL(sai3))
BUILD_ASSERT(DT_NUM_CLOCKS(DT_NODELABEL(sai3)) == 2);
BUILD_ASSERT(DT_SAME_NODE(DT_CLOCKS_CTLR_BY_IDX(DT_NODELABEL(sai3), 0), DT_NODELABEL(ccm)));
BUILD_ASSERT(DT_CLOCKS_CELL_BY_IDX(DT_NODELABEL(sai3), 0, name) == IMX_CCM_SAI3_CLK);
BUILD_ASSERT(!DT_SAME_NODE(DT_CLOCKS_CTLR_BY_IDX(DT_NODELABEL(sai3), 0),
			   DT_CLOCKS_CTLR_BY_IDX(DT_NODELABEL(sai3), 1)));
#endif

#if DT_NODE_HAS_STATUS_OKAY(DT_NODELABEL(micfil))
BUILD_ASSERT(DT_NODE_HAS_PROP(DT_NODELABEL(micfil), clocks));
BUILD_ASSERT(DT_SAME_NODE(DT_CLOCKS_CTLR_BY_IDX(DT_NODELABEL(micfil), 0), DT_NODELABEL(ccm)));
BUILD_ASSERT(DT_CLOCKS_CELL_BY_IDX(DT_NODELABEL(micfil), 0, name) == IMX_CCM_PDM_CLK);
#endif

#if DT_NODE_HAS_STATUS_OKAY(DT_NODELABEL(sdma3))
BUILD_ASSERT(DT_NODE_HAS_PROP(DT_NODELABEL(sdma3), clocks));
BUILD_ASSERT(DT_SAME_NODE(DT_CLOCKS_CTLR_BY_IDX(DT_NODELABEL(sdma3), 0), DT_NODELABEL(ccm)));
BUILD_ASSERT(DT_CLOCKS_CELL_BY_IDX(DT_NODELABEL(sdma3), 0, name) == IMX_CCM_SDMA3_CLK);
#endif

int main(void)
{
	return 0;
}
```
