## drivers/audio/Kconfig.dmic_esp32
```kconfig
# Copyright 2026 NXP
# SPDX-License-Identifier: Apache-2.0

config AUDIO_DMIC_ESP32
	bool "ESP32 DMIC adapter (PDM over I2S)"
	default y
	depends on DT_HAS_ESPRESSIF_ESP32_DMIC_ENABLED
	select I2S
	select I2S_ESP32_PDM_RX
	help
	  Enable the ESP32 DMIC adapter. It exposes the Zephyr DMIC API on top of
	  an ESP32 I2S peripheral configured for PDM RX, so DMIC clients can
	  capture a PDM MEMS microphone. Selects the PDM RX mode of the ESP32 I2S
	  driver.
```

## drivers/audio/Kconfig.dmic_mpxxdtyy
```kconfig
# Copyright (c) 2018 STMicroelectronics
# SPDX-License-Identifier: Apache-2.0

config AUDIO_DMIC_MPXXDTYY
	bool "ST Digital PDM microphone attached to I2S support"
	default y
	depends on DT_HAS_ST_MPXXDTYY_ENABLED
	select I2S
	select HAS_STLIB
	help
	  Enable MPXXDTYY microphone support on the selected board

if AUDIO_DMIC_MPXXDTYY

config DMIC_MPXXDTYY_PDM_BLOCK_SIZE
	int "PDM block size in bytes"
	default 512
	help
	  Size of one block in the internal slab the PDM bitstream is captured
	  into, before it is decimated to PCM. The bitstream is larger than the
	  PCM it produces by the oversampling factor divided by the sample
	  width, so this bounds the PCM block a caller can ask for: at a
	  decimation of 64 and 16-bit samples it is four times as large.

endif # AUDIO_DMIC_MPXXDTYY
```

## drivers/dma/Kconfig.nxp_sdma
```kconfig
# Copyright 2024 NXP
# SPDX-License-Identifier: Apache-2.0

config DMA_NXP_SDMA
	bool "NXP SDMA driver"
	default y
	depends on DT_HAS_NXP_SDMA_ENABLED
	help
		Enable driver for NXP's SDMA IP.

config DMA_NXP_SDMA_BD_COUNT
	int "Number of buffer descriptors per SDMA channel"
	depends on DMA_NXP_SDMA
	default 4
	range 2 64
	help
	  Depth of the per-channel buffer-descriptor pool. For scatter-gather
	  consumers (I2S/SAI) this bounds how many blocks dma_reload() can
	  queue ahead of the engine; it must exceed the block_count passed to
	  dma_config() so reload() has room to append. SOF's fixed-ring use is
	  unaffected (it configures its own block count).
```

## drivers/i2s/Kconfig.nxp_sai_sdma
```kconfig
# Copyright 2026 NXP
# SPDX-License-Identifier: Apache-2.0

config I2S_NXP_SAI_SDMA
	bool "NXP SAI I2S driver using SDMA transfers"
	default y
	depends on DT_HAS_NXP_SAI_SDMA_ENABLED
	depends on CLOCK_CONTROL
	depends on DMA
	depends on PINCTRL
	help
	  Enable the I2S driver for NXP SAI instances whose transfers are
	  carried by an SDMA engine (i.MX8M family Cortex-M cores). The SDMA
	  channels are obtained through the DMA API, so the SDMA instance
	  stays shareable with other peripherals.

if I2S_NXP_SAI_SDMA

config I2S_NXP_SAI_SDMA_QUEUE_DEPTH
	int "Block queue depth per direction"
	default 8
	help
	  Number of memory blocks each direction can hold in flight, and so how
	  much audio the driver buffers: a depth of 8 at 10 ms per block is
	  80 ms before a block reaches the wire. Lower it for latency, raise it
	  for tolerance of a late producer.

	  Two lower bounds apply. It must not exceed the buffer descriptors the
	  SDMA driver allocates per channel (DMA_NXP_SDMA_BD_COUNT), or blocks
	  are handed to descriptors still in use. It must also be at least the
	  number of blocks any sink queues before starting the stream, since
	  such a sink cannot start until they all fit.

config I2S_NXP_SAI_SDMA_SILENCE_SIZE
	int "Silence buffer size in bytes"
	default 256
	help
	  Bytes transferred by a descriptor the caller has not yet filled. It
	  only has to bridge the gap until the next block is queued, so it is
	  much shorter than a block; the cost of that is an uneven drain, as a
	  silence descriptor completes several times per real block.

endif # I2S_NXP_SAI_SDMA
```

## dts/bindings/audio/espressif,esp32-dmic.yaml
```yaml
# Copyright 2026 NXP
# SPDX-License-Identifier: Apache-2.0

description: |
  ESP32 DMIC adapter. Exposes the Zephyr DMIC API on top of an ESP32 I2S
  peripheral configured for PDM RX (CONFIG_I2S_ESP32_PDM_RX). Used to capture a
  PDM MEMS microphone through the I2S controller, which performs the PDM to PCM
  conversion in hardware.

compatible: "espressif,esp32-dmic"

include: base.yaml

properties:
  i2s:
    type: phandle
    required: true
    description: |
      Phandle to the ESP32 I2S device that captures the PDM microphone. That
      I2S node must be enabled and built with CONFIG_I2S_ESP32_PDM_RX.
```

## dts/bindings/audio/st,mpxxdtyy-i2s.yaml
```yaml
# Copyright (c) 2018 STMicroelectronics
# SPDX-License-Identifier: Apache-2.0

description: STMicroelectronics MPXXDTYY digital PDM microphone family

compatible: "st,mpxxdtyy"

include: i2s-device.yaml

properties:
  mic-count:
    type: int
    default: 1
    enum: [1, 2]
    description: |
      Microphones sharing the data line. Two are interleaved by clock edge and
      separated again in software; one is decimated directly and then spread
      across the channels the caller asked for. Every in-tree board carries a
      single microphone.
```

## dts/bindings/dma/nxp,sdma.yaml
```yaml
# Copyright 2024 NXP
# SPDX-License-Identifier: Apache-2.0

description: |
  NXP Smart DMA controller.

  The channel cell is the peripheral event/request source. The driver allocates
  the physical SDMA channel independently with dma_request_channel(). The mux
  cell selects an MCUX SDMA peripheral script: 5 is Normal SP and 6 is
  MultiFifo PDM. Bit 7 is reserved for the driver's runtime append-mode flag
  and must not appear in a devicetree DMA specifier.

compatible: "nxp,sdma"

include: [dma-controller.yaml, base.yaml]

properties:
  reg:
    required: true
  "#dma-cells":
    const: 2
  dma-requests:
    required: true
    description: Number of peripheral event/request sources

dma-cells:
  - channel
  - mux
```

## dts/bindings/i2s/nxp,sai-sdma.yaml
```yaml
# Copyright 2026 NXP
# SPDX-License-Identifier: Apache-2.0

description: |
  NXP SAI configured as an I2S controller, with transfers carried by an SDMA
  engine (i.MX8M family Cortex-M cores, e.g. i.MX8MP SAI3 + SDMA3 in AUDIOMIX).

  The SDMA channels are taken from the standard dmas/dma-names properties, so
  the SDMA instance stays owned by its own nxp,sdma controller node and remains
  shareable with the other peripherals wired to it.

compatible: "nxp,sai-sdma"

include: [base.yaml, pinctrl-device.yaml]

properties:
  reg:
    required: true

  interrupts:
    required: true
    description: SAI interrupt, used to report FIFO underrun and overrun.

  clocks:
    required: true
    description: |
      SAI bus/root clock. Its rate is used as the MCLK frequency for bit clock
      divider setup.

  dmas:
    required: true
    description: |
      TX and RX DMA specifiers. The channel cell carries the SDMA request line
      the direction is wired to and the mux cell the SDMA peripheral type.

  dma-names:
    required: true
    description: Must be "tx" and "rx".

  mclk-output:
    type: boolean
    description: Drive the master clock as an output pin.

  rx-sync-mode:
    type: boolean
    description: |
      The receiver has no clocks of its own and samples on the transmitter's
      bit and frame clock. Set this on boards that wire a single clock pair to
      the codec, where the codec runs its ADC from the DAC frame clock. Capture
      then produces no data until the transmitter is running.
```

## dts/bindings/i2s/st,stm32-i2s-common.yaml
```yaml
# Copyright (c) 2018, STMicroelectronics
# SPDX-License-Identifier: Apache-2.0

# Common fields for STM32 I2S peripherals.

include: [i2s-controller.yaml, pinctrl-device.yaml]

properties:
  reg:
    required: true

  interrupts:
    required: true

  dmas:
    required: true

  dma-names:
    required: true

  pinctrl-0:
    required: true

  pinctrl-names:
    required: true

  mck-enabled:
    type: boolean
    description: |
      Master Clock Output function.
      An mck pin must be listed within pinctrl-0 when enabling this property.

  ioswp:
    type: boolean
    description: Swap I2S data input and output pins

  channel-length-32:
    type: boolean
    description: |
      Pad each channel to 32 bits while keeping 16-bit data, so a frame
      carries 64 bit clocks. Devices such as I2S MEMS microphones require a
      32-bit slot but supply fewer data bits. Has no effect unless the
      configured word size is 16.
```

## samples/subsys/mp/audio_loopback/boards/esp32_devkitc_esp32_procpu.conf
```kconfig
#
# Copyright 2026 NXP
#
# SPDX-License-Identifier: Apache-2.0
#

CONFIG_AUDIO_CODEC=y
CONFIG_AUDIO_CODEC_DUMMY=y
CONFIG_AUDIO_DMIC=y
CONFIG_AUDIO_DMIC_ESP32=y
CONFIG_I2S=y
CONFIG_I2S_ESP32=y
CONFIG_I2S_ESP32_PDM_RX=y

CONFIG_MP_ZAUD_BUFFER_POOL_SZ_MAX=4096
CONFIG_MP_ZAUD_BUFFER_POOL_NUM_MAX=8
```

## samples/subsys/mpipe/audio_loopback/Kconfig
```kconfig
# Copyright 2026 NXP
# SPDX-License-Identifier: Apache-2.0

source "Kconfig.zephyr"

choice SAMPLE_AUDIO_SOURCE
	prompt "Capture source the pipeline reads from"
	default SAMPLE_AUDIO_SOURCE_DMIC

config SAMPLE_AUDIO_SOURCE_DMIC
	bool "Digital microphone"

config SAMPLE_AUDIO_SOURCE_I2S
	bool "I2S receiver"

endchoice

config SAMPLE_AUDIO_GAIN_PERCENT
	int "Gain applied by the pipeline (percent)"
	default 90
	range 0 1000

config USE_I2S_TARGET_CODEC_CONTROLLER
	bool "I2S BCK is generated by a selected codec device"
	help
	  If selected, the I2S selected peripheral will be configured to consume
	  (receive) the I2S BCK and WS signals and the codec will be configured
	  to generate those. If not selected, the I2S peripheral will generate
	  them and the codec will be expected to consume them.

config SAMPLE_AUDIO_BIT_WIDTH
	int "Sample bit width the pipeline is constrained to"
	default 0
	range 0 32
	help
	  Constrain format negotiation to this bit width. Zero leaves the width
	  unconstrained, so negotiation picks the narrowest the devices agree
	  on. Set it where a device needs a wider frame than that, such as an
	  I2S microphone requiring 64 bit clocks per frame.

config SAMPLE_AUDIO_SAMPLE_RATE
	int "Sample rate the pipeline is constrained to, in Hz"
	default 0
	help
	  Constrain format negotiation to this sample rate. Zero leaves the
	  rate unconstrained, so negotiation picks the lowest the devices agree
	  on. Set it where a board's audio clock can only be exact at certain
	  rates, or where the lowest common rate is not the one wanted.
```

## soc/nxp/imx/imx8m/Kconfig
```kconfig
# Copyright 2024 NXP
# SPDX-License-Identifier: Apache-2.0

config SOC_MIMX8MM6_A53
	select ARM64
	select CPU_CORTEX_A53
	select ARM_ARCH_TIMER if SYS_CLOCK_EXISTS
	select HAS_MCUX if CLOCK_CONTROL
	select HAS_MCUX_RDC
	select HAS_MCUX_CACHE
	select SOC_PREP_HOOK

config SOC_MIMX8MM6_M4
	select ARM
	select CPU_CORTEX_M4
	select CPU_HAS_FPU
	select CPU_HAS_ARM_MPU
	select HAS_MCUX
	select HAS_MCUX_RDC
	select SOC_EARLY_INIT_HOOK

config SOC_MIMX8ML8_A53
	select ARM64
	select CPU_CORTEX_A53
	select ARM_ARCH_TIMER if SYS_CLOCK_EXISTS
	select HAS_MCUX if CLOCK_CONTROL
	select HAS_MCUX_RDC
	select HAS_MCUX_CACHE
	select SOC_PREP_HOOK

config SOC_MIMX8MN6_A53
	select ARM64
	select CPU_CORTEX_A53
	select ARM_ARCH_TIMER if SYS_CLOCK_EXISTS
	select HAS_MCUX if CLOCK_CONTROL
	select HAS_MCUX_RDC
	select HAS_MCUX_CACHE
	select SOC_PREP_HOOK

config SOC_MIMX8ML8_ADSP
	select XTENSA
	select XTENSA_HAL if ("$(ZEPHYR_TOOLCHAIN_VARIANT)" != "xcc" && "$(ZEPHYR_TOOLCHAIN_VARIANT)" != "xt-clang")
	select XTENSA_RESET_VECTOR
	select XTENSA_USE_CORE_CRT1
	select ATOMIC_OPERATIONS_BUILTIN
	select GEN_ISR_TABLES
	select XTENSA_SMALL_VECTOR_TABLE_ENTRY
	select HAS_MCUX if CLOCK_CONTROL
	select PINCTRL_IMX if PINCTRL
	select CPU_HAS_DCACHE

config SOC_MIMX8ML8_M7
	select ARM
	select CPU_CORTEX_M7
	select CPU_HAS_FPU
	select CPU_HAS_ICACHE
	select CPU_HAS_DCACHE
	select INIT_VIDEO_PLL
	select HAS_MCUX
	select HAS_MCUX_RDC
	select CPU_HAS_ARM_MPU
	select CPU_HAS_CUSTOM_FIXED_SOC_MPU_REGIONS
	select ARM_MPU
	select SOC_EARLY_INIT_HOOK

config SOC_MIMX8MQ6_M4
	select ARM
	select CPU_CORTEX_M4
	select CPU_HAS_FPU
	select CPU_HAS_ARM_MPU
	select HAS_MCUX
	select HAS_MCUX_RDC

config MCUX_CORE_SUFFIX
	default "_ca53" if SOC_MIMX8MM6_A53 || SOC_MIMX8MN6_A53 || SOC_MIMX8ML8_A53
	default "_dsp" if SOC_MIMX8ML8_ADSP
	default "_cm4" if SOC_MIMX8MM6_M4
	default "_cm7" if SOC_MIMX8ML8_M7
	default "_cm4" if SOC_MIMX8MQ6_M4

if SOC_MIMX8ML8_M7

choice CODE_LOCATION
	prompt "Code location selection"

config CODE_ITCM
	bool "Link code into internal instruction tightly coupled memory (ITCM)"

config CODE_DDR
	bool "Link code into DDR memory"

endchoice

config INIT_VIDEO_PLL
	bool "Initialize Video PLL"

config IMX8M_M7_AUDIOMIX_BOOT_HANDOFF
	bool "Boot firmware powers and hands off AUDIOMIX"
	help
	  Enable this only when boot firmware powers the AUDIOMIX domain and
	  hands control of its clocks and peripherals to the M7. This is a boot
	  prerequisite for using SAI3, SDMA3, or MICFIL from Zephyr.

config IMX8M_M7_AUDIO_PLL1
	bool "Let the M7 own Audio PLL1 and audio roots"
	depends on IMX8M_M7_AUDIOMIX_BOOT_HANDOFF
	default y
	help
	  Allow Zephyr to reprogram the shared Audio PLL1 and the enabled audio
	  roots for the 48 kHz sample-rate family. Leave this disabled when boot
	  firmware or another core owns those clocks; the AUDIOMIX clock
	  attachments are still made so the M7 sees the roots it was handed.

endif # SOC_MIMX8ML8_M7
```

## soc/nxp/imx/imx8m/Kconfig.defconfig.mimx8ml8_m7
```kconfig
# MIMX8ML8 SoC defconfig

# Copyright (c) 2021, Laird Connectivity
# Copyright 2024 NXP
# SPDX-License-Identifier: Apache-2.0

if SOC_MIMX8ML8_M7

config SYS_CLOCK_HW_CYCLES_PER_SEC
	default 800000000

config GPIO
	default y

config IPM_IMX
	default y
	depends on IPM

if CODE_ITCM

config FLASH_SIZE
	default $(dt_node_reg_size_int,/soc/itcm@0,0,K)

config FLASH_BASE_ADDRESS
	default $(dt_node_reg_addr_hex,/soc/itcm@0)

endif # CODE_ITCM

if CODE_DDR

config FLASH_SIZE
	default $(dt_node_reg_size_int,/soc/code@80000000,0,K)

config FLASH_BASE_ADDRESS
	default $(dt_node_reg_addr_hex,/soc/code@80000000)

endif # CODE_DDR

config NUM_IRQS
	# must be >= the highest interrupt number used
	default 159

if DAI_NXP_SAI

config SAI_HAS_MCLK_CONFIG_OPTION
	# the i.MX8MP SAI IP has the MCR register (FSL_FEATURE_SAI_HAS_MCR)
	default y

endif # DAI_NXP_SAI

endif # SOC_MIMX8ML8_M7
```

## subsys/mp/ipc/Kconfig
```kconfig
#Copyright (c) 2026 Qualcomm Innovation Center, Inc. All rights reserved.
#SPDX-License-Identifier: Apache-2.0

config MP_IPC
	bool "IPC Source and Sink plugins"
	default n
	depends on IPC_SERVICE
	help
	  Enable IPC plugins for the MultimediaPipe framework to bridge a
	  pipeline across processors using the Zephyr IPC Service.
```

## subsys/mp/plugins/zaud/Kconfig
```kconfig
#
# Copyright 2025-2026 NXP
#
# SPDX-License-Identifier: Apache-2.0
#

config MP_PLUGIN_ZAUD
	bool "Audio (zaud) plugin"
	depends on AUDIO_DMIC && I2S && AUDIO_CODEC
	help
	  Enable the libMP audio plugin elements: DMIC source, gain transform
	  and I2S codec sink. These bridge Zephyr audio drivers (DMIC, I2S,
	  codec) to a libMP pipeline.

if MP_PLUGIN_ZAUD

config MP_PLUGIN_ZAUD_MAX_FRAME_SIZE
	int "Maximum audio frame size (bytes)"
	default 4096
	help
	  Upper bound, in bytes, of a single audio frame. Used to size the
	  statically allocated DMA buffers and the libMP transport buffers.

config MP_PLUGIN_ZAUD_NUM_BLOCKS
	int "Number of audio buffers per element"
	default 16
	range 8 128
	help
	  Number of buffers each audio element pre-allocates for capture /
	  playback. The I2S sink primes half of these before starting playback;
	  fewer than 8 (prebuffer < 4) underruns the native_sim I2S backend.

endif # MP_PLUGIN_ZAUD
```
