## subsys/mpipe/ipc/Kconfig
```kconfig
#
# Copyright 2026 NXP
#
# SPDX-License-Identifier: Apache-2.0
#

config MPIPE_IPC
	bool "Direct inter-core IPC protocol"
	select CRC
	help
	  Version 1 wire protocol for the direct M7 to HiFi4 link: framing,
	  CRC32C integrity, structural validation, and the paired session
	  state machine. Transport independent; it marshals bytes and decides
	  whether they are currently meaningful, while the IPC Service backend
	  moves them between cores.

config MPIPE_IPC_PLUGIN
	bool "Cross-core pipeline elements"
	depends on MPIPE_IPC && IPC_SERVICE
	help
	  Build the IPC sink and source elements, which let one pipeline span
	  two cores: it ends on one in an IPC sink and resumes on the other in
	  an IPC source. Buffers cross by reference, so the pool the sink draws
	  from must live in memory the peer can address.

config MPIPE_IPC_PLUGIN_MAX_BUFFERS
	int "Buffers an IPC sink may have outstanding with its peer"
	depends on MPIPE_IPC_PLUGIN
	default 8
	range 1 64
	help
	  How many buffers the sink hands over before it must wait for one to
	  come back. This is the pipeline's flow control across the link, and it
	  is a claim on the upstream buffer pool: every outstanding buffer is one
	  the source feeding this pipeline cannot reuse until the peer is done
	  with it, a whole cross-core round trip later.

	  The pool must therefore be larger than this by the rest of the
	  pipeline's in-flight demand. Setting it at or above the pool size
	  deadlocks: the sink takes every buffer and the source that fills them
	  can never allocate another.
```

## tests/drivers/clock_control/nxp_clock_dt_spec/dts/bindings/vnd,nxp-clock-consumer.yaml
```yaml
description: Test consumer of NXP-style clock specifiers

compatible: "vnd,nxp-clock-consumer"

include: base.yaml

properties:
  clocks:
    required: true
```

## tests/drivers/clock_control/nxp_clock_dt_spec/dts/bindings/vnd,nxp-clock-zero-cell.yaml
```yaml
description: |
  Test clock controller with no cells. A consumer of this provider has no
  identifier to pass, so its clock subsystem is zero.

compatible: "vnd,nxp-clock-zero-cell"

include: clock-controller.yaml

properties:
  "#clock-cells":
    const: 0
```
