## sample.yaml
```
sample:
  name: MP IPC loopback pipeline sample

tests:
  sample.mp.ipc_loopback:
    tags:
      - mp
      - ipc
      - samples
    platform_allow:
      - qemu_cortex_a53
      - native_sim/native/64
    integration_platforms:
      - qemu_cortex_a53
    harness: console
    harness_config:
      type: one_line
      regex:
        - "Received Frame"
```

## prj.conf
```kconfig
# Copyright 2026 NXP
# SPDX-License-Identifier: Apache-2.0

CONFIG_MP=y
CONFIG_IPC_SERVICE=y
CONFIG_MP_IPC=y

# Disable cache management for QEMU loopback simulation to avoid arch-specific linker issues
CONFIG_CACHE_MANAGEMENT=n

# MediaPipe Subsystem Config
CONFIG_MP_THREADS_NUM=2
CONFIG_MP_NET_BUF_POOL_COUNT=8
CONFIG_MP_FAKE_SRC=y
CONFIG_MP_FAKE_SRC_BUF_SZ=128

# Logging Configuration
CONFIG_LOG=y
CONFIG_LOG_DEFAULT_LEVEL=3
CONFIG_MP_LOG_LEVEL_DBG=y

# Heap and buffer allocations
CONFIG_HEAP_MEM_POOL_SIZE=16384
CONFIG_NET_BUF=y
```

## boards/native_sim_native_64.overlay
```dts
/*
 * Copyright 2026 NXP
 *
 * SPDX-License-Identifier: Apache-2.0
 */

/ {
	ipc0: ipc0 {
		compatible = "ipc-service-backend";
		status = "okay";
	};
};
```

## src/main.c
```c
/*
 * Copyright 2026 NXP
 *
 * SPDX-License-Identifier: Apache-2.0
 */

#include <zephyr/kernel.h>
#include <zephyr/logging/log.h>
#include <zephyr/net_buf.h>

#include <zephyr/mp/mp.h>
#include <zephyr/mp/mp_pipeline.h>
#include <zephyr/mp/mp_bin.h>
#include <zephyr/mp/mp_element.h>
#include <zephyr/mp/mp_pad.h>
#include <zephyr/mp/mp_fake_src.h>
#include <zephyr/mp/ipc/mp_ipc.h>
#include <zephyr/mp/ipc/mp_ipc_protocol.h>

#include "mp_test_sink.h"

LOG_MODULE_REGISTER(mp_ipc_loopback_app, LOG_LEVEL_INF);

#define PIPE_A_ID    0
#define FAKE_SRC_ID  1
#define IPC_SINK_ID  2

#define PIPE_B_ID    3
#define IPC_SRC_ID   4
#define TEST_SINK_ID 5

static struct mp_pipeline pipeline_a;
static struct mp_fake_src fake_src;
static struct mp_ipc_sink ipc_sink;

static struct mp_pipeline pipeline_b;
static struct mp_ipc_src ipc_src;
static struct mp_test_sink test_sink;

int main(void)
{
	int ret;

	LOG_INF("--- Starting Approach 1: Single-Binary Loopback Simulation ---");
	LOG_INF("Topology: [fake_src] -> [ipc_sink] ===== (IPC Loopback) =====> [ipc_src] -> [test_sink]");

	/* 1. Build the pipelines and elements using standard MP_ELEMENT_INIT */
	MP_ELEMENT_INIT(&pipeline_a, mp_pipeline_init, PIPE_A_ID);
	MP_ELEMENT_INIT(&fake_src, mp_fake_src_init, FAKE_SRC_ID);
	MP_ELEMENT_INIT(&ipc_sink, mp_ipc_sink_init, IPC_SINK_ID);

	MP_ELEMENT_INIT(&pipeline_b, mp_pipeline_init, PIPE_B_ID);
	MP_ELEMENT_INIT(&ipc_src, mp_ipc_src_init, IPC_SRC_ID);
	MP_ELEMENT_INIT(&test_sink, mp_test_sink_init, TEST_SINK_ID);

	/* 2. Link elements together using upstream-compliant mp_element_link */
	ret = mp_element_link((struct mp_element *)&fake_src, (struct mp_element *)&ipc_sink, NULL);
	if (ret < 0) {
		LOG_ERR("Failed to link elements on Pipeline A (%d)", ret);
		return ret;
	}

	ret = mp_element_link((struct mp_element *)&ipc_src, (struct mp_element *)&test_sink, NULL);
	if (ret < 0) {
		LOG_ERR("Failed to link elements on Pipeline B (%d)", ret);
		return ret;
	}

	/* 3. Add elements to respective bins */
	ret = mp_bin_add((struct mp_bin *)&pipeline_a, (struct mp_element *)&fake_src, (struct mp_element *)&ipc_sink, NULL);
	if (ret < 0) {
		LOG_ERR("Failed to add elements to Pipeline A (%d)", ret);
		return ret;
	}

	ret = mp_bin_add((struct mp_bin *)&pipeline_b, (struct mp_element *)&ipc_src, (struct mp_element *)&test_sink, NULL);
	if (ret < 0) {
		LOG_ERR("Failed to add elements to Pipeline B (%d)", ret);
		return ret;
	}

	/* 4. Start Pipeline B (Slave / Receiver Side) */
	LOG_INF("Starting Pipeline B...");
	if (mp_element_set_state((struct mp_element *)&pipeline_b, MP_STATE_PLAYING) != MP_STATE_CHANGE_SUCCESS) {
		LOG_ERR("Failed to start Pipeline B");
		return -EIO;
	}

	/* 5. Start Pipeline A (Master / Sender Side) */
	LOG_INF("Starting Pipeline A...");
	if (mp_element_set_state((struct mp_element *)&pipeline_a, MP_STATE_PLAYING) != MP_STATE_CHANGE_SUCCESS) {
		LOG_ERR("Failed to start Pipeline A");
		return -EIO;
	}

	/* 6. Wait for EOS message on Pipeline B's Bus (notifying that processing is complete) */
	LOG_INF("Pipeline is playing. Waiting for EOS / complete message on Bus...");
	struct mp_bus *bus = mp_element_get_bus((struct mp_element *)&pipeline_b);
	struct mp_message msg;

	mp_bus_pop_msg(bus, MP_MESSAGE_ERROR | MP_MESSAGE_EOS, &msg);

	switch (msg.type) {
	case MP_MESSAGE_ERROR:
		LOG_ERR("ERROR message from element %d", msg.origin->object.id);
		break;
	case MP_MESSAGE_EOS:
		LOG_INF("EOS message from element %d (SUCCESS: Frame transfer completed)", msg.origin->object.id);
		break;
	default:
		LOG_ERR("Unexpected message from element %d", msg.origin->object.id);
		break;
	}

	/* Stop/Deinit both pipelines */
	LOG_INF("Stopping pipelines...");
	(void)mp_element_set_state((struct mp_element *)&pipeline_a, MP_STATE_READY);
	(void)mp_element_set_state((struct mp_element *)&pipeline_b, MP_STATE_READY);

	LOG_INF("--- Approach 1 Completed Successfully ---");
	return 0;
}
```

## src/mp_test_sink.c
```c
/*
 * Copyright 2026 NXP
 *
 * SPDX-License-Identifier: Apache-2.0
 */

#include <zephyr/kernel.h>
#include <zephyr/logging/log.h>
#include <zephyr/net_buf.h>

#include <zephyr/mp/mp_bus.h>
#include <zephyr/mp/mp_message.h>
#include <zephyr/mp/mp_element.h>
#include <zephyr/mp/mp_caps.h>
#include <zephyr/mp/mp_dispatch.h>

#include "mp_test_sink.h"

LOG_MODULE_DECLARE(mp_ipc_loopback_app, LOG_LEVEL_INF);

static int mp_test_sink_chainfn(struct mp_pad *pad, struct net_buf *buf, struct net_buf **out_buf)
{
	struct mp_test_sink *self = (struct mp_test_sink *)pad->object.container;
	struct mp_buffer_meta *meta = mp_buffer_get_meta(buf);

	self->frame_count++;
	LOG_INF("[Pipeline B: mp_test_sink] Received Frame %d: size=%u, timestamp=%u", 
		self->frame_count, buf->len, meta->timestamp);

	/* When we receive 3 frames, post an EOS message to Pipeline B's bus */
	if (self->frame_count >= 3) {
		struct mp_bus *bus = mp_element_get_bus((struct mp_element *)self);
		if (bus) {
			struct mp_message eos_msg;
			MP_MESSAGE_INIT(&eos_msg, (struct mp_element *)self, MP_MESSAGE_EOS);
			mp_bus_post(bus, &eos_msg);
		}
	}

	if (out_buf) {
		*out_buf = NULL;
	}
	return 0;
}

static int mp_test_sink_queryfn(struct mp_pad *pad, struct mp_dispatch *query)
{
	if (query->type == MP_DISPATCH_CAPS) {
		struct mp_caps *caps = mp_caps_new_any();
		mp_dispatch_set_caps(query, caps);
		mp_caps_unref(caps);
		return 0;
	} else if (query->type == MP_DISPATCH_BUFFER_CONFIG) {
		return 0;
	}
	return -ENOTSUP;
}

void mp_test_sink_init(struct mp_element *self)
{
	struct mp_test_sink *tsink = (struct mp_test_sink *)self;
	mp_sink_init(self);
	tsink->base.sinkpad.chainfn = mp_test_sink_chainfn;
	tsink->base.sinkpad.queryfn = mp_test_sink_queryfn;
	tsink->frame_count = 0;
}
```
